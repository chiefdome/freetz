## branches/sf3978_packages/make/chatd/Config.in
```kconfig
config FREETZ_PACKAGE_CHATD
	bool "chatd 0.1 (binary only)"
	default n
	help
		simple and lightweight chat server, for telnet & co.
		start server: ./chatd <port> &
		start client(s): telnet <IP address server> <port>
		WWW: http://www.andreadrian.de/select/
```

## branches/sf3978_packages/make/connect/Config.in
```kconfig
config FREETZ_PACKAGE_CONNECT
	bool "connect 1.100 (binary only)"
	default n
	help
		connect is the simple relaying command to make network connection
		via SOCKS and https proxy. It is mainly intended to be used as proxy
		command of OpenSSH. You can make SSH session beyond the firewall with
		this command.
		Features of connect are:
		    * Supports SOCKS (version 4/4a/5) and https CONNECT method.
		    * Supports NO-AUTH and USERPASS authentication of SOCKS
		    * You can input password from tty, ssh-askpass or environment variable.
		    * Run on UNIX or Windows platform.
		    * Simple and general program independent from OpenSSH.
		    * You can also relay local socket stream instead of standard I/O.
		WWW: http://bent.latency.net/bent/git/goto-san-connect-1.85/src/connect.html#sec1
```

## branches/sf3978_packages/make/darkhttpd/Config.in
```kconfig
config FREETZ_PACKAGE_DARKHTTPD
	bool "darkhttpd 1.8 (binary only)"
	select FREETZ_LIB_STDCXXLIB
	default n
	help
		darkhttpd is a web server.
		Simple to set up:
		  * Single binary, no other files, no installation needed.
		  * Standalone, doesn't need inetd or ucspi-tcp.
		  * No messing around with config files - all you have to
		    specify is the www root.
		WWW: http://unix4lyfe.org/darkhttpd/
```

## branches/sf3978_packages/make/darkstat/Config.in
```kconfig
config FREETZ_PACKAGE_DARKSTAT
	bool "darkstat 3.0.714 (binary only)"
	select FREETZ_LIB_libpcap
	select FREETZ_LIB_libz
	default n
	help
		 darkstat is a packet sniffer that runs as a background process on a cable/DSL
		 router, gathers all sorts of statistics about network usage, and serves them
		 over HTTP.
		 WWW: http://dmr.ath.cx/net/darkstat/
```

## branches/sf3978_packages/make/dccserver/Config.in
```kconfig
config FREETZ_PACKAGE_DCCSERVER
	bool "dccserver 0.4 (binaries only)"
	default n
	help
		  dccserver - simulate mIRC's /dccserver command. dccserver aims
		  to provide the functions of mIRC's /dccserver command.
		  Currently, Chat and Send (including resume) modes are supported.
		  Fserve and Get mode are not yet supported. All connections are
		  accepted; some simple checks on allowed file names are done.
		  During connectione establishment, there is a 15 seconds timeout;
		  during transfers, it is 2 minutes. Chats have no timeout. 
		  WWW: http://nih.at/dccserver/dccserver.html
```

## branches/sf3978_packages/make/devio/Config.in
```kconfig
config FREETZ_PACKAGE_DEVIO
	bool "devio 1.2 (binary only)"
	default n
	help
		A command line program to correctly read (or write) a region
		of a block device. Primary use is for extracting formatted
		data from MTD partitions. The primary difference between devio
		and other command line utilities, such as dd and cat, is that
		it is not stream based - it writes directly into the object
		rather than reading and writing a stream of data.
		WWW: http://devio.sourceforge.net/
		manual: http://devio.sourceforge.net/devio-manual/index.htm
```

## branches/sf3978_packages/make/dhcpcd/Config.in
```kconfig
config FREETZ_PACKAGE_DHCPCD
	bool "dhcpcd 4.99.7 (binary only)"
	select FREETZ_LIB_STDCXXLIB
	default n
	help
		  DHCP client for automatically configuring IPv4 networking.
		  Simple configuration: supports executions of a script when
		  the IP address changes.
		  WWW: http://roy.marples.name/projects/dhcpcd
		  Manpage: http://www.daemon-systems.org/man/dhcpcd.8.html
```

## branches/sf3978_packages/make/dnsproxy/Config.in
```kconfig
config FREETZ_PACKAGE_DNSPROXY
	bool "dnsproxy 1.16 (binary only)"
	select FREETZ_LIB_libevent
	default n
	help
		The dnsproxy daemon is a proxy for DNS queries. It forwards these
		queries to two previously configured nameservers: one for authoritative
		queries and another for recursive queries. The received answers are
		sent back to the client unchanged. No local caching is done.
		Primary motivation for this project was the need to replace Bind
		servers with djbdns in an ISP environment. These servers get recursive
		queries from customers and authoritative queries from outside at the
		same IP address. Now it is possible to run dnscache and tinydns on
		the same machine with queries dispatched by dnsproxy.
		Other scenarios are firewalls where you want to proxy queries to the
		real servers in your DMZ. Or internal nameservers behind firewalls, or... 
		WWW: http://www.wolfermann.org/dnsproxy.html
```

## branches/sf3978_packages/make/dnsreflector/Config.in
```kconfig
config FREETZ_PACKAGE_DNSREFLECTOR
	bool "dnsreflector 1.02 (binary only)"
	default n
	help
		The dnsreflector daemon listens for DNS queries on a local UDP port and
		answers with records pointing back to localhost. Combined with iptables
		this works as a bandwidth efficient spamtrap.
		WWW: http://www.wolfermann.org/dnsreflector.html
```

## branches/sf3978_packages/make/dudders/Config.in
```kconfig
config FREETZ_PACKAGE_DUDDERS
	bool "dudders 1.04 (binary and libraries only)"
	select FREETZ_LIB_libcrypto
	select FREETZ_LIB_libssl
	select FREETZ_LIB_libgcrypt
	default n
	help
		dudders is a utility for updating DNS records.  It points
		a domain name to a given IP address, using the RFC2136 DNS
		UPDATE protocol and a SIG(0) signature.  It is designed with
		embedded systems in mind. dudders is licensed under the Apache
		License, Version 2.0, the text of which is included in the file
		COPYING.
		WWW: http://dudders.sourceforge.net/
		Manpage: http://dudders.sourceforge.net/dudders.8.html
		mailing list: <dudders-users@lists.sourceforge.net>
```

## branches/sf3978_packages/make/elog/Config.in
```kconfig
config FREETZ_PACKAGE_ELOG
	bool "elog 2.7.8-1 (binary only)"
	default n
	help
		 ELOG is part of a family of applications known as weblogs.
		 Their general purpose is: 1. to make it easy for people to
		 put information online in a chronological fashion, in the
		 form of short, time-stamped text messages ("entries") with
		 optional HTML markup for presentation, and optional file
		 attachments (images, archives, etc.). 2. to make it easy
		 for other people to access this information through a Web
		 interface, browse entries, search, download files, and
		 optionally add, update, delete or comment on entries.
		 elogd ist the weblog server and elog is a standalone
		 "client" program.
		 https://midas.psi.ch/elog/
```

## branches/sf3978_packages/make/email/Config.in
```kconfig
config FREETZ_PACKAGE_EMAIL
	bool "email 3.1.3 (binary only)"
	select FREETZ_LIB_libcrypto
	select FREETZ_LIB_libssl
	select FREETZ_LIB_libm
	default n
	help
		  Email is a program for the Unix environment that sends messages. You may
		  think that this has already been done, and it has, but not with the quality
		  and enhancements that email has! Have you ever wanted to send email from
		  the command line using your SMTP server instead of sendmail? Have you ever
		  wanted to send email without entering a confusing menu application and you
		  only wanted to push a few command line options to route your email to the
		  SMTP server of your choice? Did you want to encrypt that email with gpg
		  before it was sent but wanted the email client to do it for you? If you
		  answered yes to all of these questions, then email is for you. You can now
		  send email via the command line to remote SMTP servers. You can have it
		  encrypted to the recipient of your choice. This and many other possibilities
		  are easily implemented with email.
		  Email boasts a lot of other qualities as well.
		    * Email supports SMTP Authentication.
		    * Email makes it possible to send to multiple recipients and also CC and
		      BCC multiple recipients.
		    * You can use an address book that is in an easy to format method.
		    * You are also able to send attachments using a swift flick on the command
		      line to specifying multiple files.
		    * Personalized signature file with dynamic options.
		  Email makes it simple to implement in cron jobs. You can pipe data into email
		  and it will accept it as your message which will bypass opening your editor, and
		  mail it properly. Also, you can tell email to stay quiet and never display any
		  output (except for errors) when operating. This way you won't get those annoying
		  emails from cron jobs when your cron job did actually work correctly.
		  There are plenty of things email can do, but it's not going to do them until you
		  download it! 
		  WWW: http://www.cleancode.org/projects/email
```

## branches/sf3978_packages/make/emech/Config.in
```kconfig
config FREETZ_PACKAGE_EMECH
	bool "emech 3.0.99p3 (binary only)"
	default n
	help
		The EnergyMech is a fully functional IRC bot, written entirely
		in the C programming language. It has common features such as
		userlists, shitlists, channel protection, DCC partyline, botnet
		and lots more.
		The EnergyMech started out as a hack of the combot but is today
		quite different and more sophisticated. One of the main ideas of
		the EnergyMech is that it should be easy both to setup and use.
		The popular eggdrop requires that TCL is installed on a system
		for it to compile sucessfully, the EnergyMech has no such
		requirements. A person that is familiar with UNIX would have no
		trouble installing an EnergyMech and getting it up and running.  
		WWW: http://www.energymech.net/features.html
```

## branches/sf3978_packages/make/ethstatus/Config.in
```kconfig
config FREETZ_PACKAGE_ETHSTATUS
	bool "ethstatus 0.4.3 (binary only)"
	select FREETZ_LIB_libncurses
	default n
	help
		ethstatus is a console-based monitoring utility for displaying
		statistical data of the ethernet interface on a quantity basis.
		Manpage: http://manpages.ubuntu.com/manpages/hardy/man1/ethstatus.1.html
```

## branches/sf3978_packages/make/inadyn/Config.in
```kconfig
config FREETZ_PACKAGE_INADYN
	bool "inadyn 1.98.1 (binary only)"
	select FREETZ_LIB_libresolv
	default n
	help
		Inadyn is a simple and small DDNS client. By using a DDNS client
		such as inadyn you can register an Internet name at certain providers
		that the DDNS client updates, periodically and/or on demand when your IP
		changes. Inadyn can maintain MULTIPLE host NAMES with the SAME IP address,
		and has a WEB BASED IP DETECTION which RUNS well BEHIND a NAT router.
		Inadyn supports updating SEVERAL DDNS servers, SEVERAL ACCOUNTS even on
		DIFFERENT DDNS providers.

		Common DDNS service providers supported by inadyn:
		    http://www.dyndns.org
		    http://freedns.afraid.org
		    http://www.zoneedit.com
		    http://www.no-ip.com
		    http://www.easydns.com
		    http://www.tzo.com
		    http://www.3322.org
		    http://www.dnsomatic.com
		    http://www.tunnelbroker.net, i.e., http://dns.he.net/
		    http://www.dynsip.org
		    http://www.sitelutions.com

		This is a fork of the original INADYN implementation from Narcis Ilisei. Most
		of the fixes and additions from the new "upstream" by Christoph Brill have been
		added. Excluding the GNU Autotools build system introduction, Windows platform
		fixes and a highly suspicious set of base64 API fixes from inadyn-advanced.
		However, this project is not a fork off of Christoph's repository, but rather a
		reengineered version of the original 1.96.2 release with all additional patches
		audited and merged separately. Additionally a further set of code cleanups,
		features and bug fixes have been added. The most interesting one, which no other
		Inadyn fork seems to have, is a fix to a rather nasty socket leak.
		The goal of this project is to entirely focus on *BSD, UN*X and various embedded
		Linux platforms. All sane patches addressing this target audience are welcome! 
		WWW: http://vmlinux.org/jocke/inadyn.shtml
		www: http://eyrich-net.org/programmiertes.html
		git: https://github.com/troglobit/inadyn
```

## branches/sf3978_packages/make/iplog/Config.in
```kconfig
config FREETZ_PACKAGE_IPLOG
	bool "iplog 2.2.3 (binary only)"
	select FREETZ_LIB_libpcap
	default n
	help
		  iplog is a TCP/IP traffic logger.  Currently, it is capable of logging
		  TCP, UDP and ICMP traffic, though adding support for other protocols
		  should be relatively easy. iplog contains a built-in packet filter,
		  allowing for logging or excluding packets that fit a given set of
		  criteria.
		  WWW: http://ojnk.sourceforge.net/
		  Readme: http://ojnk.sourceforge.net/stuff/iplog.readme
```

## branches/sf3978_packages/make/ippd-master/Config.in
```kconfig
config FREETZ_PACKAGE_IPPD_MASTER
	bool "ippd-master 1.0.0 (binary only)"
	default n
	help
		Yaa Ippd is an ipp(Internet Printing Protocol) server.
		It's small and fast. It is more suitable for embedded
		system. As now, it only supports Linux.
		Why use Yaa Ippd? 
		For the IPP is a protocol which is widely supported in
		most OSs, and it can be used on Internel with url.
		(P910nd doesn`t support this function.) As an
		application layer protocol, IPP has one of its designed
		goals, not to invent new security features when it can
		use existing protocols. 
		We know that CUPS supports ipp, and it is more powerful.
		Why not we use it? Because it is so powerful that it
		have so many functions that we don`t need. For most
		embedded system, we only need a printer server
		application, and the smaller the better.
		Features:
		1. Only use basic library. So, It can easily run in most
		    system.
		2. Support simultaneously printing works. And that only
		    uses one thread(also, one process). So, it doesn't
		    need a pthread library, and doesn't need CPU cost of
		    processes switching.
		3. Minimal memory cost.
		4. Minimal CPU cost.
		5. Support SSL.(On developing.)
		6. Support IPv6.(On developing.)
		7. Better architecture. Object-oriented code with C  
		WWW: http://www.yaabou.com/prj/ippd/
```

## branches/sf3978_packages/make/iroffer/Config.in
```kconfig
config FREETZ_PACKAGE_IROFFER
	bool "iroffer 1.4.b03-lamm.b02 (binary only)"
	select FREETZ_LIB_libcrypt
	default n
	help
		  iroffer is a fileserver for irc (commonly referred to as a DCC bot). It
		  uses the DCC feature of irc to send files to other users. iroffer will
		  connect to an irc server and let people request files from it.
		  This is a fork of Iroffer with extended features.
		  It does support mIRC-style DCC Server Protocol.
		  LICENSE: GPL2 or later
		  WWW1: http://iroffer.org/docs/quick_start.html
		  WWW2: http://iroffer-lamm.sourceforge.net/
		  WWW3: http://sourceforge.net/projects/iroffer-lamm/
```

## branches/sf3978_packages/make/jnettop/Config.in
```kconfig
config FREETZ_PACKAGE_JNETTOP
	bool "jnettop 0.13.0 (binary only)"
	select FREETZ_LIB_STDCXXLIB
	select FREETZ_LIB_libpthread
	select FREETZ_LIB_libpcap
	select FREETZ_LIB_libgthread_2
	select FREETZ_LIB_libpcre
	select FREETZ_LIB_libdl
	select FREETZ_LIB_librt
	select FREETZ_LIB_libncurses
	default n
	help
		  Jnettop is a traffic visualiser, which captures traffic going
		  through the host it is running from and displays streams sorted
		  by bandwidth they use.
		  WWW: http://jnettop.kubs.info/wiki/
```

## branches/sf3978_packages/make/libs/ldns/Config.in
```kconfig
config FREETZ_LIB_ldns
	bool "ldns (libldns.so)"
	default n
	help
		A library to simplify DNS programming
		http://www.nlnetlabs.nl/projects/ldns/
```
