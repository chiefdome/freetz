## branches/sf3978_packages/make/libs/libdlna/Config.in
```kconfig
config FREETZ_LIB_libdlna
	bool "libdlna (libdlna.so)"
	select FREETZ_LIB_libavformat
	select FREETZ_LIB_libavcodec
	select FREETZ_LIB_libavutil
	default n
	help
		libdlna aims at being the reference open-source implementation of DLNA
		(Digital Living Network Alliance) standards. Its primary goal is to
		provide DLNA support to uShare, an embedded DLNA & UPnP A/V Media Server,
		but it will be used to build both DLNA servers and players in the long
		term.
```

## branches/sf3978_packages/make/libs/libidn/Config.in
```kconfig
config FREETZ_LIB_libidn
	bool "libidn (libidn.so)"
	default n
	help
		GNU Libidn is a fully documented implementation of the Stringprep,
		Punycode and IDNA specifications. Libidn's purpose is to encode and
		decode internationalized domain names.
```

## branches/sf3978_packages/make/libs/libupnp/Config.in
```kconfig
config FREETZ_LIB_libupnp
	bool "libupnp (libupnp.so)"
	default n
	help
		The portable SDK for UPnP Devices (libupnp) provides developers with an API and
		open source code for building control points, devices, and bridges that are
		compliant with Version 1.0 of the  Universal Plug and Play Device Architecture
		Specification.

config FREETZ_LIB_libixml
	bool "libixml (libixml.so)"
	default n
	help
		UPnP shared libraries

config FREETZ_LIB_libthreadutil
	bool "libthreadutil (libthreadutil.so)"
	default n
	help
		UPnP shared libraries
```

## branches/sf3978_packages/make/monit/Config.in
```kconfig
config FREETZ_PACKAGE_MONIT
	bool "monit 5.2.5 (binary only)"
	select FREETZ_LIB_libssl
	select FREETZ_LIB_libcrypto
	default n
	help
		  Monit is a free open source utility for managing and monitoring, processes,
		  files, directories and filesystems on a UNIX system. Monit conducts automatic
		  maintenance and repair and can execute meaningful causal actions in error
		  situations.   
		  WWW: http://mmonit.com/monit/
		  Documentation: http://mmonit.com/monit/documentation/monit.html
		  Wiki: http://mmonit.com/wiki/
```

## branches/sf3978_packages/make/motion/Config.in
```kconfig
config FREETZ_PACKAGE_MOTION
	bool "motion 3.2.12 (binary only)"
	select FREETZ_LIB_libpthread
	select FREETZ_LIB_libjpeg
	select FREETZ_LIB_libm
	default n
	help
		Motion is a program that monitors the video signal from one or
		more cameras and is able to detect if a significant part of the
		picture has changed; in other words, it can detect motion. 
		WWW: http://www.lavrsen.dk/foswiki/bin/view/Motion/WebHome
```
