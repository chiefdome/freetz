## branches/sf3978_packages/make/udptunnel/Config.in
```kconfig
config FREETZ_PACKAGE_UDPTUNNEL
	bool "udptunnel r16 (binary only)"
	default n
	help
		This project tunnels TCP data through a UDP tunnel. The executable can act as
		the server or client. The server acts as a proxy for the client, listening
		on a specified UDP port and creating a connection to a TCP server that the
		client specifies. The client listens on a TCP port, acting as the server that
		some TCP client connects to. The client recevies any TCP data on that port 
		and sends the data to the udpserver, which sends it to the TCP connection it
		made with the desired TCP server.   
		WWW: https://code.google.com/p/udptunnel/
```

## branches/sf3978_packages/make/uhub/Config.in
```kconfig
config FREETZ_PACKAGE_UHUB
	bool "uhub 0.3.2 (binary only)"
	select FREETZ_LIB_libssl
	default n
	help
		uhub is a high performance peer-to-peer hub for the ADC network.
	        Its low memory footprint allows it to handle several thousand users
	        on high-end servers, or a small private hub on embedded hardware.  
		WWW: http://www.uhub.org/index.php
		config: http://www.uhub.org/config.php
```

## branches/sf3978_packages/make/ushare/Config.in
```kconfig
config FREETZ_PACKAGE_USHARE
	bool "ushare 1.1a (binary only)"
	select FREETZ_LIB_libupnp
	select FREETZ_LIB_libixml
	select FREETZ_LIB_libthreadutil
	select FREETZ_LIB_libintl
	select FREETZ_LIB_libdlna
	select FREETZ_LIB_libavcodec
	select FREETZ_LIB_libavutil
	select FREETZ_LIB_libavformat
	select FREETZ_PACKAGE_FFMPEG
	default n
	help
		  uShare is a UPnP (TM) A/V & DLNA Media Server. It implements the server
		  component that provides UPnP media devices with information on available
		  multimedia files. uShare uses the built-in http server of libupnp to stream
		  the files to clients. GeeXboX uShare is able to provide access to both
		  images, videos, music or playlists files (see below for a complete file
		  format support list). It does not act as an UPnP Media Adaptor and thus,
		  can't transcode streams to fit the client requirements. uShare is written
		  in C for the GeeXboX project. It is designed to provide access to multimedia
		  contents to GeeXboX but can of course be used by any other UPnP client device.
		  It should compile and run on any modern POSIX compatible system such as Linux.
		  uShare is free software - it is licensed under the terms of the GNU General
		  Public License (GPL).  
		  WWW: http://ushare.geexbox.org/
		  Usage: http://ushare.geexbox.org/#Usage
```

## branches/sf3978_packages/make/vgp/Config.in
```kconfig
config FREETZ_PACKAGE_VGP
	bool "vgp 0.2.1 (binary only)"
	default n
	help
		VGP (Virtual Gateway Protocol) is a very simple protocol able to 
	        work in a way similar to Cisco(c) HSRP. It implements the idea 
	        of Virtual Gateway to provide fault tollerance (and load 
	        balancing) on your net. Each client on your net has as its 
	        default gateway set to the virtual gateway and not the real router.
		WWW: http://vgpd.freaknet.org
```

## branches/sf3978_packages/make/weborf/Config.in
```kconfig
config FREETZ_PACKAGE_WEBORF
	bool "weborf 0.13 (binary only)"
	default n
	help
		  Weborf is a lightweight webserver designed to rapidly share directories.
		  Weborf uses the thread pool pattern to handle his threads. When it starts
		  it creates a first group of thread, and they will serve incoming connections
		  without terminating. If there are more connections than threads, a second
		  group of thread is created. And so on… When the hi-traffic situation is over,
		  it will slowly terminate existing threads, to free memory. If the number of
		  threads reaches the limit, new incoming connections will be dropped.
		  Weborf is also able to execute scripts. It is also possible to use script to
		  perform authentication. Weborf can be used to let clients surf a site. It is
		  possible to start it quickly, with no need of being superuser. So it is often
		  a good choice to share a directory with other people without needing a
		  particular client. Weborf supports both IPv4 and IPv6. Works on POSIX compliant
		  systems, Weborf is written in C. Supports basic authentication, but doesn't implement
		  completely the http specification. Can be used to easily share directories,
		  since it's basedir can be set using directly the command line. Allows the execution
		  of server-side cgi scripts and implements the thread-pool pattern to reuse it's
		  threads. Works on GNU/Linux and MacOsX. Has a partial support for webdav. 
		  WWW: http://galileo.dmi.unict.it/wiki/weborf/doku.php
```
