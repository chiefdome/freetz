## branches/sf3978_packages/make/tlsproxyd/Config.in
```kconfig
config FREETZ_PACKAGE_TLSPROXYD
	bool "tlsproxyd 0.0.2 (binary only)"
	select FREETZ_LIB_libssl
	select FREETZ_LIB_libcrypto
	default n
	help
		tlsproxyd is a general proxying daemon for TLS/SSL. It allows you to connect
		TLS-enabled clients to non-TLS-enabled servers, presumably over a secure
		network so as not to miss the point entirely. It requires OpenSSL.
		It differs from stunnel, sslwrap etc. in that it is a stand alone daemon,
		rather than a program which runs from inetd. This is primarily so that it can
		conveniently be used with a certificate which has a pass phrase. Also, stunnel
		especially has a history of security holes; tlsproxyd is intended to be as
		simple as possible, so as to avoid any obvious pitfalls of this sort. (The
		third reason for writing it was to learn something about SSL; the take home
		message from this exercise is, `SSL: run screaming and don't look back'.  
		WWW: http://www.ex-parrot.com/~chris/tlsproxyd/
		Manpage: http://www.ex-parrot.com/~chris/tlsproxyd/tlsproxyd.8.html
		Readme: http://www.ex-parrot.com/~chris/tlsproxyd/README
```

## branches/sf3978_packages/make/tmdns/Config.in
```kconfig
config FREETZ_PACKAGE_TMDNS
	bool "tmdns 0.5.3 (binary only)"
	default n
	help
		  tmdns is tiny/trivial Multicast DNS Responder for Linux. It
		  should allow you to take part in a zeroconf environment.
		  tmdns is Copyright (C) 2003 Andreas Hofmeister
		  (andreas.hofmeister@pyramid.de) and others (see Authors &
		  History below).
		  WWW: http://zeroconf.sourceforge.net/
```

## branches/sf3978_packages/make/transocksev/Config.in
```kconfig
config FREETZ_PACKAGE_TRANSOCKSEV
	bool "transocksev 0.0.1 (binary only)"
	select FREETZ_LIB_libevent
	default n
	help
		transocksev is a transparent socks proxy, inspired by the idea of
		transocks (http://transocks.sourceforge.net).
		In some cases you might redirect TCP/IP-Traffic on your network-router
		trough a transparent SOCKS-Proxy. tranSOCKS_ev is a user-space daemon for
		linux that does this job perfectly based on iptable-filter-rules.
		WWW: http://oss.tiggerswelt.net/transocks_ev/
```

## branches/sf3978_packages/make/ttcp/Config.in
```kconfig
config FREETZ_PACKAGE_TTCP
	bool "ttcp 3.8 (binary only)"
	default n
	help
		A small utility to test TCP connection performance.
		WWW: https://dev.openwrt.org/browser/packages/net/ttcp/
```

## branches/sf3978_packages/make/udpcast/Config.in
```kconfig
config FREETZ_PACKAGE_UDPCAST
	bool "udpcast 20100130 (binaries only)"
	select FREETZ_LIB_libpthread
	default n
	help
		UDPcast is a file transfer tool that can send data simultaneously
		to many destinations on a LAN. This can for instance be used to
		install entire classrooms of PC's at once. The advantage of UDPcast
		over using other methods (nfs, ftp, whatever) is that UDPcast uses
		Ethernet's multicast abilities: it won't take longer to install 15
		machines than it would to install just 2.
		UDPcast is released under the GPL 2.0 license. Parts of the code (fec.c)
		falls under a BSD-like license. The new boot loader contains cardmgr,
		which falls under the mozilla public license. All other included third-party
		software (busybox, dialog, lzop, udhcp, ...) falls under GPL (to the best
		of my knowledge. If you notice software falling under a different license,
		especially one with a BSD-like publicity clause, please notify me).
		UDPcast can be started from the included busybox boot image for OS
		installations, or from the command line when using it for other purposes.
		Udpcast may be booted from CD, floppy media, or via the network, by uding
		PXE or Etherboot. A configuration file (udpcfg.txt) may be included on
		these boot media in order to bypass the setup menu.
		There is an udpcast mailing list at udpcast@udpcast.linux.lu . Please send
		all bug reports to this list. Note: You must be subscribed to the list in
		order to be able to send comments. You may subscribe to the list by sending
		a message with 'subscribe' in its body or subject to udpcast-request@udpcast.linux.lu,
		or by visiting: https://udpcast.linux.lu/mailman/listinfo/udpcast 
		WWW: http://udpcast.linux.lu/source.html
```
