## branches/sf3978_packages/make/muh/Config.in
```kconfig
config FREETZ_PACKAGE_MUH
	bool "muh 2.2a (binary only)"
	default n
	help
		  muh is a smart IRC-bouncing tool that remains on IRC all the time.
		  You can take control over your nick by connecting to muh with an
		  IRC client that is able to supply a password for the server connection.
		  WWW: http://muh.sourceforge.net/
```

## branches/sf3978_packages/make/nast/Config.in
```kconfig
config FREETZ_PACKAGE_NAST
	bool "nast 0.2.0 (binary only)"
	select FREETZ_LIB_libpthread
	select FREETZ_LIB_libncurses
	select FREETZ_LIB_libpcap
	select FREETZ_LIB_libnet
	select FREETZ_LIB_libmenu
	default n
	help
		Nast is a packet sniffer and a LAN analyzer based on Libnet and Libpcap.
		It can sniff in normal mode or in promiscuos mode the packets on a network
		interface and log it.  It dumps the headers of packets and the payload in
		ascii or ascii-hex format.  You can apply a filter. The sniffed data can be
		saved in a separated file.
		As analyzer tool, it has many features like:
		  * Build LAN hosts list
		  * Follow a TCP-DATA stream
		  * Find LAN internet gateways
		  * Discorver promiscous nodes
		  * Reset an established connection
		  * Perform a single half-open portscanner
		  * Perform a multi half-open portscanner
		  * Find link type (hub or switch)
		  * Catch daemon banner of LAN nodes
		  * Control arp answers to discover possible arp-spoofings
		  * Byte couting with an optional filter
		  * Write reports logging
		It also provides a new ncurses interface.
		WWW: http://nast.berlios.de/
```

## branches/sf3978_packages/make/ndyndns/Config.in
```kconfig
config FREETZ_PACKAGE_NDYNDNS
	bool "ndyndns 2.1 (binary only)"
	select FREETZ_LIB_libcurl
	select FREETZ_LIB_libcrypto
	select FREETZ_LIB_libssl
	default n
	help		 
		ndyndns is a GPL'ed update client written in C that supports custom,
		static, and dynamic DNS. It avoids unnecessary updates, reports errors,
		logs to syslog, and generally ought to be compliant with everything
		required for a proper dyndns client. It is written to be secure and
		supports running as an unprivileged process in a chroot jail. SSL-encrypted
		transfers are also supported.
		ndyndns is dependent on cURL and currently works on Linux and the BSDs,
		but is easily portable to other POSIX platforms.
		WWW: http://code.google.com/p/ndyndns/
```

## branches/sf3978_packages/make/netperf/Config.in
```kconfig
config FREETZ_PACKAGE_NETPERF
	bool "netperf 2.4.5 (binaries only)"
	default n
	help
		Netperf is a benchmark that can be used to measure the
		performance of many different types of networking. It
		provides tests for both unidirecitonal throughput, and
		end-to-end latency. The environments currently measureable
		by netperf include:
		  * TCP and UDP via BSD Sockets for both IPv4 and IPv6
		  * DLPI
		  * Unix Domain Sockets
		  * SCTP for both IPv4 and IPv6  
		WWW: http://www.netperf.org/netperf/
		manual: http://www.netperf.org/svn/netperf2/tags/netperf-2.4.5/doc/netperf.html
		manpage: http://manpages.ubuntu.com/manpages/lucid/man1/netperf.1.html
```

## branches/sf3978_packages/make/netscript/Config.in
```kconfig
config FREETZ_PACKAGE_NETSCRIPT
	bool "netscript 1.7.1 (binary only)"
	select FREETZ_LIB_libdl
	default n
	help
		netscript (portable/multi-platform) is a lightweight tcp/udp socket
		scripting. Intended for (non-)experienced persons to be able to use
		to automate situations, built on a word-to-word ruleset response system,
		includes wildcard support, character replacement, random replacement,
		argument inclusion, server timeout, initial send, display altering,
		multiple character dump formats, telnet protocol support, logging,
		program to socket dumping, executable ruleset support, reverse binding,
		module support, data truncation, data formatting, permission options,
		virtual hosting support, history storage, dynamic storage variables,
		directory placement, character omitting, timed rules, background support,
		syslog support, routing support, socket options, interactive mode, and a
		graphical user interface among other things.
		AUTHOR: v9@fakehalo.deadpig.org, fakehalo.deadpig.org. [ihadnihn]
		www: http://netscript.sourceforge.net/
```

## branches/sf3978_packages/make/nylon/Config.in
```kconfig
config FREETZ_PACKAGE_NYLON
	bool "nylon 1.21 (binary only)"
	select FREETZ_LIB_libpthread
	select FREETZ_LIB_libevent
	select FREETZ_LIB_libresolv
	select FREETZ_LIB_librt
	default n
	help
		nylon is a proxy server, developed on OpenBSD. It supports SOCKS
		version 4 and 5, as well as a mirror mode so that services can be
		mirrored directly. It is compatible with BSD, Solaris, HP-UX and
		Linux.
		WWW: http://monkey.org/~marius/pages/?page=nylon
```

## branches/sf3978_packages/make/odsclient/Config.in
```kconfig
config FREETZ_PACKAGE_ODSCLIENT
	bool "odsclient 1.03 (binary only)"
	select FREETZ_LIB_libresolv
	default n
	help
		update client for Open Domain Server (ODS).
		Code by Aaron Sethman <androsyn@ratbox.org> for use with ODS and dnsQ
		Modified ever so slightly by Jason DiCioccio <geniusj@ods.org>
		Usage: odsclient username password hostname [ipaddress]
		WWW: http://www.ods.org/
```

## branches/sf3978_packages/make/opendchub/Config.in
```kconfig
config FREETZ_PACKAGE_OPENDCHUB
	bool "opendchub 0.8.2 (binary only)"
	select FREETZ_LIB_libpcap
	select FREETZ_LIB_libcrypto
	select FREETZ_LIB_libz
	default n
	help
		  OpenDChub is a Unix/Linux version of the hub software for the Direct Connect Network.
		  Direct Connect (DC) is a file sharing network made up by hubs, to which clients can
		  connect. Once connected to a hub, the user can search for files on the hub or the
		  network, or browse files of other users connected to the hub.
		  WWW: http://opendchub.sourceforge.net/
```

## branches/sf3978_packages/make/parprouted/Config.in
```kconfig
config FREETZ_PACKAGE_PARPROUTED
	bool "parprouted 0.65 (binary only)"
	select FREETZ_LIB_libpthread
	default n
	help
		parprouted is a daemon for transparent IP (Layer 3) proxy ARP bridging.
	        This is useful for creation of transparent firewalls and bridging networks
	        with different MAC protocols. Also, unlike standard bridging, proxy ARP
	        bridging allows to bridge Ethernet networks behind wireless nodes without
	        using WDS or layer 2 bridging.  
		WWW: http://www.hazard.maks.net/parprouted/
```

## branches/sf3978_packages/make/pcapsipdump/Config.in
```kconfig
config FREETZ_PACKAGE_PCAPSIPDUMP
	bool "pcapsipdump 0.1.4 (binary only)"
	select FREETZ_LIB_STDCXXLIB
	select FREETZ_LIB_libpcap
	default n
	help
		pcapsipdump is a tool for dumping SIP sessions (+RTP traffic, if available) to disk in a
	        fashion similar to "tcpdump -w" (format is exactly the same), but one file per sip session
	        (even if there is thousands of concurrect SIP sessions). pcapsipdump can also be used to
		split "bulk" pcap file into bunch of individual files (one per call):pcapsipdump -r 
		<bulkfile> -d <dir-for-bunch-of-files>
		WWW: http://sourceforge.net/projects/pcapsipdump/
```

## branches/sf3978_packages/make/pound/Config.in
```kconfig
config FREETZ_PACKAGE_POUND
	bool "pound 2.5 (binaries only)"
	select FREETZ_LIB_libpcre
	select FREETZ_LIB_libdl
	select FREETZ_LIB_libm
	select FREETZ_LIB_libpthread
	select FREETZ_LIB_libresolv
	select FREETZ_LIB_libpcreposix
	default n
	help
		The Pound program is a reverse proxy, load balancer
		and HTTPS front-end for Web server(s). Pound was
		developed to enable distributing the load among several
		Web-servers and to allow for a convenient SSL wrapper
		for those Web servers that do not offer it natively.
		Pound is distributed under the GPL - no warranty, it's
		free to use, copy and give away.
		http://www.apsis.ch/pound/index_html
```

## branches/sf3978_packages/make/sipp/Config.in
```kconfig
config FREETZ_PACKAGE_SIPP
	bool "sipp 3.2 (binary only)"
	select FREETZ_LIB_STDCXXLIB
	select FREETZ_LIB_libncurses
	default n
	help
		SIPp is a free Open Source test tool / traffic generator for the SIP protocol.
		It includes a few basic SipStone user agent scenarios (UAC and UAS) and
		establishes and releases multiple calls with the INVITE and BYE methods. It can
		also reads custom XML scenario files describing from very simple to complex call
		flows. It features the dynamic display of statistics about running tests (call
		rate, round trip delay, and message statistics), periodic CSV statistics dumps,
		TCP and UDP over multiple sockets or multiplexed with retransmission management
		and dynamically adjustable call rates.
		Other advanced features include support of IPv6, TLS, SIP authentication, conditional
		scenarios, UDP retransmissions, error robustness (call timeout, protocol defense), call
		specific variable, Posix regular expression to extract and re-inject any protocol
		fields, custom actions (log, system command exec, call stop) on message receive, field
		injection from external CSV file to emulate live users.
		SIPp can also send media (RTP) traffic through RTP echo and RTP / pcap replay. Media
		can be audio or audio+video.
		While optimized for traffic, stress and performance testing, SIPp can be used to run
		one single call and exit, providing a passed/failed verdict.
		Last, but not least, SIPp has a comprehensive documentation available both in HTML and
		PDF format.
		SIPp can be used to test many real SIP equipements like SIP proxies, B2BUAs, SIP media
		servers, SIP/x gateways, SIP PBX, ... It is also very useful to emulate thousands of
		user agents calling your SIP system.
		WWW: http://sipp.sourceforge.net/
```

## branches/sf3978_packages/make/sipsak/Config.in
```kconfig
config FREETZ_PACKAGE_SIPSAK
	bool "sipsak 0.9.6 (binary only)"
	select FREETZ_LIB_libcrypto
	default n
	help
		  sipsak is a small command line tool (stress and diagnostics utility)
		  for developers and administrators of Session Initiation Protocol (SIP)
		  applications. It can be used for some simple tests on SIP applications
		  and devices.
		  WWW: http://www.sipsak.org/
```

## branches/sf3978_packages/make/sock/Config.in
```kconfig
config FREETZ_PACKAGE_SOCK
	bool "sock 1.1 (binary only)"
	select FREETZ_LIB_libresolv
	select FREETZ_LIB_libnsl
	default n
	help
		This program serves as an interface for network sockets for use
		in both shell scripts and manually from the command line. In
		contrast to netcat, it handles EOF in a way so, for example, tar
		archives can easily be transferred. See the man page (man 1 sock)
		for more details.   
		WWW: http://dir.filewatcher.com/d/SuSE/9.1/i586/Productivity/Networking/Other/sock-1.1-120.i586.rpm.12455.html
		Hompage: http://atrey.karlin.mff.cuni.cz/~mj/linux.shtml
```

## branches/sf3978_packages/make/sslh/Config.in
```kconfig
config FREETZ_PACKAGE_SSLH
	bool "sslh 1.11 (binary only)"
	select FREETZ_PACKAGE_TCP_WRAPPERS
	default n
	help
		sslh accepts HTTPS, SSH and OpenVPN connections on the same port. This
		makes it possible to connect to an SSH server or an OpenVPN on port 443
		(e.g. from inside a corporate firewall, which almost never block port
		443) while still serving HTTPS on that port.
		sslh-select uses only one thread, which monitors all connections
		at once. It is more recent and less tested, but only incurs a 16 byte
		overhead per connection. Also, if it stops, you'll lose all connections,
		which means you can't upgrade it remotely. If you are going to use sslh
		for a "small" setup (less than a dozen ssh connections and a low-traffic
		https server) then sslh-fork (= sslh) is probably more suited for you.
		WWW: http://rutschle.net/tech/sslh.shtml
```

## branches/sf3978_packages/make/stund/Config.in
```kconfig
config FREETZ_PACKAGE_STUND
	bool "stund 0.1 (binaries only)"
	select FREETZ_LIB_STDCXXLIB
	default n
	help
		The STUN protocol (Simple Traversal of UDP through NATs) is
		described in the IETF RFC 3489, available at
		http://www.ietf.org/rfc/rfc3489.txt. It's used to help clients
		behind NAT to tunnel incoming calls through. This server is the
		counterpart to help the client identify the NAT and have it open
		the proper ports for it.
		WWW: http://sourceforge.net/projects/stun/
```

## branches/sf3978_packages/make/tcpick/Config.in
```kconfig
config FREETZ_PACKAGE_TCPICK
	bool "tcpick 0.2.1 (binary only)"
	select FREETZ_LIB_libpcap
	default n
	help
		tcpick is a textmode sniffer libpcap-based that can track, reassemble
		and reorder tcp streams. tcpick is able to save the captured flows in
		different files or displays them in the terminal, and so it is useful
		to sniff files that are transmitted via ftp or http. It can display all
		the stream on the terminal, when the connection is closed in different
		display modes like hexdump, hexdump + ascii, only printable charachters,
		raw mode and so on. Actually it can handle several interfaces, including
		ethernet cards and ppp. It is useful to	keep track of what users of a
		network are doing, and is usable with textmode tools like grep, sed, awk.
		WWW: http://tcpick.sourceforge.net/
		Manpage: http://tcpick.sourceforge.net/?t=1&p=OPTIONS
		Examples of tcpick usage: http://tcpick.sourceforge.net/?t=1&p=EXAMPLES
```

## branches/sf3978_packages/make/tcpreen/Config.in
```kconfig
config FREETZ_PACKAGE_TCPREEN
	bool "tcpreen 1.4.4 (binary only)"
	select FREETZ_LIB_libiconv
	select FREETZ_LIB_libintl
	select FREETZ_LIB_STDCXXLIB
	default n
	help
		  TCPreen is a simple tool to monitor and analyze data transmitted between
		  clients and servers through connection-oriented streams data such as a
		  TCP sessions; it supports TCP over either IPv4 or IPv6. This tool focuses
		  on the data stream (software/socket layer), not on the lower level
		  transmission protocol as packet sniffers do. TCPreen listens on a TCP port
		  and wait for incoming connections to come in. Then, it forwards data sent
		  by the connecting client to another server port (possibly on another computer)
		  and forwards server responses back to the client. TCPreen can display data on
		  your console in real-time and/or save it to log files for later reference.
		  Various display formats are available. While it was originally meant to help
		  developers reverse-engineer TCP-based protocols, it can also be very useful
		  to debug network server or client software or for a system administrator to
		  monitor a TCP service. 
		  WWW: http://www.remlab.net/tcpreen/
		  Manpage: http://manpages.ubuntu.com/manpages/hardy/man1/tcpreen.1.html
```

## branches/sf3978_packages/make/thc-ipv6/Config.in
```kconfig
config FREETZ_PACKAGE_THC_IPV6
	bool "thc-ipv6 1.6 (binaries only)"
	select FREETZ_LIB_STDCXXLIB
	select FREETZ_LIB_libssl
	select FREETZ_LIB_libcrypto
	select FREETZ_LIB_libpcap
	default n
	help
		THC is proud to be the first who are releasing an comprehensive attack
		toolkit for the IPv6 protocol suite. It comprises of state-of-the-art
		tools for alive scanning, man-in-the-middle attacks, denial-of-service
		etc. which exploits inherent vulnerabilities in IPv6. Included is a fast
		and easy to use packet crafting library to create your own attack tools.  
		WWW: http://freeworld.thc.org/releases.php
```

## branches/sf3978_packages/make/throttle/Config.in
```kconfig
config FREETZ_PACKAGE_THROTTLE
	bool "throttle 1.2 (binary only)"
	default n
	help
		throttle is a simple pipe which rate limits data
		passed from standard input to output.
		WWW: http://klicman.org/throttle/
```
