## branches/busybox/make/busybox/Config.in
```kconfig
menu "menuconfig"
	source make/busybox/config/Config.in
endmenu

config FREETZ_BUSYBOX__MANDATORY
	bool "mandatory"
	select FREETZ_BUSYBOX_REALPATH
	select FREETZ_BUSYBOX_STUN_IP

config FREETZ_BUSYBOX__ADDITIONAL
	bool "additional"
#	select  ...

config FREETZ_BUSYBOX__IPV6_UTILS
	bool "ipv6"
#	select  ...

config FREETZ_BUSYBOX__NET_EXPERT
	bool "network"
#	select  ...
```

## branches/private/kriegaex/sf3978_packages/make/adsuck/Config.in
```kconfig
config FREETZ_PACKAGE_ADSUCK
	bool "adsuck 2.3 (binary only)"
	select FREETZ_LIB_libldns
	select FREETZ_LIB_libevent
	default n
	help
		adsuck is a small DNS server that spoofs blacklisted addresses and forwards all
		other queries. The idea is to be able to prevent connections to undesirable
		sites such as ad servers, crawlers, etc. It can be used locally, for the road
		warrior, or on the network perimeter in order to protect local machines from
		malicious sites.  
		WWW: http://freshmeat.net/projects/adsuck
		WIKI: http://opensource.conformal.com/wiki/Adsuck
```

## branches/private/kriegaex/sf3978_packages/make/aeke/Config.in
```kconfig
config FREETZ_PACKAGE_AEKE
	bool "aeke r4 (binaries only)"
	select FREETZ_LIB_STDCXXLIB
	select FREETZ_LIB_libcrypto
	select FREETZ_LIB_libutil
	select FREETZ_LIB_libz
	select FREETZ_LIB_libdl
	default n
	help
		Aeke is a light-weight, SSH-like program that uses an identity-based
		authentication protocol to guard against MITM attacks.
		Aeke consists of three distinct programs:
		aeked - the server. This is conceptually equivalent to sshd(8), but
		with a few important differences.
		aeke - the client program, conceptually equivalent to ssh(1). This
		is a commandline based program used to connect to an aeked server.
		aeke_cp - the copy program, similar to scp.
		WWW: https://aeke.googlecode.com/svn/trunk/
		Readme: https://aeke.googlecode.com/svn/trunk/README
```

## branches/private/kriegaex/sf3978_packages/make/aget/Config.in
```kconfig
config FREETZ_PACKAGE_AGET
	bool "aget 0.4.1 (binary only)"
	default n
	help
		aget is a multithreaded HTTP download accelerator.
		Pointed on the Win32 Project Flashget.
		WWW: http://www.enderunix.org/aget/
```

## branches/private/kriegaex/sf3978_packages/make/arpon/Config.in
```kconfig
config FREETZ_PACKAGE_ARPON
	bool "arpon 2.6 (binary only)"
	select FREETZ_LIB_libpthread
	select FREETZ_LIB_libpcap
	select FREETZ_LIB_libdnet
	select FREETZ_LIB_libnet
	default n
	help
		ArpON (Arp handler inspectiON) is a portable handler daemon that
		make ARP secure in order to avoid the Man In The Middle through
		ARP Spoofing/Poisoning. Detects/blocks the DNS, WEB Spoofing,
		Session Hijacking, SSL/TLS Hijacking & co attacks.
		  Features:
		    * Proactive based solution for:
		      Point to point, Multipoint
		    * Support for networks:
		      Statically, Dinamically (DHCP), Hybrid network that is statically
		      and dinamically
		    * Blocks the Man In The Middle (MITM) attack through:
		      ARP Spoofing, ARP Cache Poisoning, ARP Poison Routing (APR)
		    * Three kinds of anti ARP Spoofing tecniques:
		      SARPI or Static ARP Inspection, DARPI or Dynamic ARP Inspection,
		      HARPI or Hybrid ARP Inspection
		    * Blocks the derived attacks:
		      Sniffing, Hijacking, Injection, Filtering & co attacks
		    * Blocks the complex derived attacks:
		      DNS Spoofing, WEB Spoofing, Session Hijacking, SSL/TLS Hijacking
		      & co attacks
		    * Support of Gratuitous ARP request and reply for:
		      Failover Cluster, Cluster with load-balancing, High-Availability
		      (HA) Cluster
		    * Manages the network interface with:
		      Unplug iface, Boot OS, Hibernation OS, Suspension OS
		    * Retro compatible with:
		      Classic ARP standard base protocol by IETF
		    * Tested against:
		      Ettercap, Cain & Abel, DSniff, Yersinia, scapy, arpspoof, netcut,
		      sslspoof, sslstrip & co tools
		WWW: http://arpon.sourceforge.net/
```

## branches/private/kriegaex/sf3978_packages/make/axel/Config.in
```kconfig
config FREETZ_PACKAGE_AXEL
	bool "axel 2.4 (binary only)"
	select FREETZ_LIB_libpthread
	default n
	help
		light download accelerator - console version
		Axel tries to accelerate the downloading process by using multiple connections
		for one file. It can also use multiple mirrors for one download. Axel tries
		to be as light as possible (25-30k in binary form), so it might be useful as a
		wget clone on byte-critical systems.  
		WWW: http://axel.sourcearchive.com/documentation/2.4-1/main.html
```

## branches/private/kriegaex/sf3978_packages/make/bacnet4linux/Config.in
```kconfig
config FREETZ_PACKAGE_BACNET4LINUX
	bool "bacnet4linux 0.3.12 (binary only)"
	default n
	help
		BACnet - A Data Communication Protocol for Building Automation
		and Control Networks. Developed under the auspices of the American
		Society of Heating, Refrigerating and Air-Conditioning Engineers
		(ASHRAE), BACnet is an American national standard, a European
		standard, a national standard in more than 30 countries, and an
		ISO global standard.  
		WWW: http://sourceforge.net/projects/bacnet4linux/
```

## branches/private/kriegaex/sf3978_packages/make/balance/Config.in
```kconfig
config FREETZ_PACKAGE_BALANCE
	bool "balance 3.54 (binary only)"
	default n
	help
		Balance is a load balancing solution being a simple
		but powerful generic tcp proxy with round robin load
		balancing and failover mechanisms. Its behaviour can
		be controlled at runtime using a simple command line syntax.
		Balance supports IPv6 on the listening side which makes it
		a very useful tool for IPv6 migration of IPv4 only services
		and servers. Balance successfully runs at least on Linux(386),
		Linux(Itanium), FreeBSD, BSD/OS, Solaris, Cygwin, Mac-OS X,
		HP-UX and many more. Balance is Open Source Software and
		released under GPL licensing terms.
		http://www.inlab.de/balance.html
```

## branches/private/kriegaex/sf3978_packages/make/bandwidth/Config.in
```kconfig
config FREETZ_PACKAGE_BANDWIDTH
	bool "bandwidth 0.9.8 (binary only)"
	default n
	help
		Bandwidth-tool is a sniffer program for 802.3 networks designed
		for command line which works without using any external library.
		You can obtain the amount of kb/s of any communication and get
		statistics of ports used and traffic by IPs.  
		WWW: https://code.google.com/p/bandwidth-tool/
```

## branches/private/kriegaex/sf3978_packages/make/casu/Config.in
```kconfig
config FREETZ_PACKAGE_CASU
	bool "casu 3.3.3 (binaries only)"
	default n
	help
		casu is a collection of programs for communicating with, and showing
		the status of, other users. The package currently consists of:
		    flon --	lists your friends who are logged on
		    to --	sends a short message to another user
		WWW (german): http://packages.debian.org/lenny/casu
```

## branches/private/kriegaex/sf3978_packages/make/cmdftp/Config.in
```kconfig
config FREETZ_PACKAGE_CMDFTP
	bool "cmdftp 0.9.7 (binary only)"
	default n
	help
		  cmdftp is a command line FTP client for Unix under GPLv3. cmdftp
		  is aimed at being small and simple. Features include passive
		  mode for all data transfers, shell like transparent syntax for
		  local and remote modes, multiple and recursive file transfers
		  using wildcards, recursive copy and move commands, remote and
		  local text file viewing and editing, network errors detection
		  and resuming of currently executing command, partial download
		  resuming (if server accepts REST command), tab completion for
		  both local and remote names, autologin using classic ~/.netrc
		  approach, large file support.
		  WWW: http://www.nongnu.org/cmdftp/
```

## branches/private/kriegaex/sf3978_packages/make/coreutils/Config.in
```kconfig
config FREETZ_PACKAGE_COREUTILS
	bool "coreutils 8.12 (binaries only)"
	select FREETZ_LIB_libpcap
	select FREETZ_LIB_STDCXXLIB
	default n
	help
		  These are the GNU core utilities. This package is
		  the union of the GNU fileutils, sh-utils, and
		  textutils packages.
		  WWW: http://ftp.gnu.org/gnu/coreutils/
```

## branches/private/kriegaex/sf3978_packages/make/corkscrew/Config.in
```kconfig
config FREETZ_PACKAGE_CORKSCREW
	bool "corkscrew 2.0 (binary only)"
	default n
	help
		  Tunneling SSH through HTTP proxies.
		  Corkscrew has been tested with the following HTTP proxies :
		      * Gauntlet
		      * CacheFlow
		      * JunkBuster
		      * Squid
		      * Apache's mod_proxy 
		  WWW: http://www.agroman.net/corkscrew/
```

## branches/private/kriegaex/sf3978_packages/make/dhid/Config.in
```kconfig
config FREETZ_PACKAGE_DHID
	bool "dhid 5.5 (binaries only)"
	select FREETZ_LIB_libgmp
	default n
	help
		DHIS is a client-server based system architecture primarily meant for updating
		DNS for hosts that have dynamic IP addresses. With DHIS you can have your
		computer always recognised and available on the Internet with the same unique
		name, even if its IP address changes frequently.
		dhid is the DHIS client daemon. After setting up with the DHIS provider, each
		machine may run a dhid daemon (in background) in order to update its dynamic IP
		address within the server. Until release 4.0 DHIS was a system intended to
		provide dynamic DNS updates (on the server) only. In other words, the client
		daemon dhid would update its DNS entry within the server.
		Once running, dhid sends echo request packets to the server and expects a reply.
		Once received, dhid tries to authenticate at the server either in password or qrc
		mode. From then on, and providing authentication was successful, the client waits
		and replies to queries originated at the server. If the server doesn't receive
		acknowledgments of these packets the host is marked offline. Likewise, if the
		client doesn't receive queries for a period of time the offline stage is restored.
		Therefore, the only thing a DHIS host needs is to run the dhid client. The server
		is able to determine when the host is online and the server tables are updated
		automatically.
		From R5 the DHIS client dhid no longer implements mail relaying functions or
		interactive mode. This release of the client however supports the following
		additional features:

		    Multi-server support
		    Multi-client update support 
		    Configurable refresh rates
		    Possibility of running external commands when online/offline transitions occur.

		For an example of the possible options please see dhid.conf.sample
		WWW: http://www.dhis.org/WebEngine.ipo?context=dhis.website.home
```

## branches/private/kriegaex/sf3978_packages/make/driftnet/Config.in
```kconfig
config FREETZ_PACKAGE_DRIFTNET
	bool "driftnet 0.1.6 (binary only)"
	select FREETZ_LIB_libpcap
	default n
	help
		Driftnet is a program which listens to network traffic and picks out
		images from TCP streams it observes. Fun to run on a host which sees
		lots of web traffic.  Obviously, driftnet is an invasion of privacy
		of a fairly blatant sort. Also, if you are possessed of Victorian
		sensibilities, and share an unswitched network with others who are
		not, you should probably not use it.
		WWW: http://www.ex-parrot.com/~chris/driftnet/
```

## branches/private/kriegaex/sf3978_packages/make/dsniff/Config.in
```kconfig
config FREETZ_PACKAGE_DSNIFF
	bool "dsniff 2.4 (binaries only)"
	select FREETZ_LIB_libpcap
	select FREETZ_LIB_libnids
	select FREETZ_LIB_libnet
	select FREETZ_LIB_libssl
	select FREETZ_LIB_libcrypto
	select FREETZ_LIB_libdb
	select FREETZ_LIB_libgthread_2
	default n
	help
		  Various tools for network auditing and security testing. *** For didactic
		  and educational use only ***. Please do not abuse them.
		    arpspoof     redirect packets from a target host (or all hosts) on the LAN
				 intended for another host on the LAN by forging ARP replies.
		    dnsspoof     forge replies to arbitrary DNS address / pointer queries on
				 the LAN.
		    dsniff       simple password sniffer.
		    filesnarf    saves selected files sniffed from NFS traffic in the current
				 working directory.
		    macof        flood the local network with random MAC addresses.
		    mailsnarf    a fast and easy way to violate the Electronic Communications
				 Privacy Act of 1986 (18 USC 2701-2711), be careful.
		    msgsnarf     record selected messages from sniffed AOL Instant Messenger,
				 ICQ 2000, IRC, and Yahoo! Messenger chat sessions.
		    sshmitm      SSH monkey-in-the-middle.
		    sshow	 SSH traffic analysis tool.
		    tcpkill      kills specified in-progress TCP connections.
		    tcpnice      slow down specified TCP connections via "active" traffic
				 shaping.
		    urlsnarf     output all requested URLs sniffed from HTTP traffic in CLF
				 (Common Log Format, used by almost all web servers), suitable
				 for offline post-processing
		    webmitm      HTTP / HTTPS monkey-in-the-middle.
		  WWW: http://www.monkey.org/~dugsong/dsniff/
		  Manpage: http://linux.die.net/man/8/dsniff
		  Manpage: http://linux.die.net/man/8/arpspoof
		  Manpage: http://linux.die.net/man/8/sshow
		  Manpage: http://linux.die.net/man/8/filesnarf
		  Manpage: http://linux.die.net/man/8/macof
		  Manpage: http://linux.die.net/man/8/dnsspoof
		  Manpage: http://linux.die.net/man/8/mailsnarf
		  Manpage: http://linux.die.net/man/8/msgsnarf
		  Manpage: http://linux.die.net/man/8/sshmitm
		  Manpage: http://linux.die.net/man/8/tcpkill
		  Manpage: http://linux.die.net/man/8/tcpnice
		  Manpage: http://linux.die.net/man/8/urlsnarf
		  Manpage: http://linux.die.net/man/8/webmitm
		  Artikel: http://www.linux-magazin.de/Online-Artikel/Wenn-Programme-nach-Hause-telefonieren
```

## branches/private/kriegaex/sf3978_packages/make/elhttp/Config.in
```kconfig
config FREETZ_PACKAGE_ELHTTP
	bool "elhttp 0.22 (binary only)"
	default n
	help
		elhttp is a very light HTTP proxy server, mostly useful on embedded
		Linux systems such as ADSL routers. It supports HTTP 1.1 (keep-alive),
		the connect method, IP-based ACLs, SSL relaying, and client request
		logging. It runs on most Unix variants (Linux, *BSD, etc.) and Win32.  
```

## branches/private/kriegaex/sf3978_packages/make/fprobe/Config.in
```kconfig
config FREETZ_PACKAGE_FPROBE
	bool "fprobe 1.1 (binary only)"
	select FREETZ_LIB_libpthread
	select FREETZ_LIB_libpcap
	default n
	help
		  NetFlow probe: fprobe - libpcap-based tool that collect
		  network traffic data and emit it as NetFlow flows towards
		  the specified collector.
		  WWW: http://fprobe.sourceforge.net/
```
