## branches/private/kriegaex/sf3978_packages/make/hiawatha/Config.in
```kconfig
config FREETZ_PACKAGE_HIAWATHA
	bool "hiawatha 7.6 (binaries only)"
	select FREETZ_LIB_libpthread
	select FREETZ_LIB_libz
	default n
	help
		  Hiawatha is an open source webserver with a focus on security.
		  A very lightweight web server.
		  WWW: http://www.hiawatha-webserver.org/
		  german: http://www.admin-magazin.de/content/der-sichere-webserver-hiawatha
		  english: http://www.linux-magazine.com/Issues/2009/107/Hiawatha
		  spanish: http://www.linux-magazine.es/issue/55/018-025HiawathaLM55.pdf

config FREETZ_PACKAGE_HIAWATHA_WITH_CHROOT
	bool "enable chroot support"
	depends on FREETZ_PACKAGE_HIAWATHA
	default n
	help
		This option enable chroot support for hiawatha

config FREETZ_PACKAGE_HIAWATHA_WITH_COMMAND
	bool "enable CommandChannel"
	depends on FREETZ_PACKAGE_HIAWATHA
	default n
	help
		This option enable CommandChannel for hiawatha

config FREETZ_PACKAGE_HIAWATHA_WITH_CACHE
	bool "enable cache"
	depends on FREETZ_PACKAGE_HIAWATHA
	default n
	help
		This option enable cache for hiawatha

config FREETZ_PACKAGE_HIAWATHA_WITH_SSL
	bool "enable ssl"
	depends on FREETZ_PACKAGE_HIAWATHA
	select FREETZ_LIB_libcrypto
	select FREETZ_LIB_libssl
	default n
	help
		This option enable ssl for hiawatha

config FREETZ_PACKAGE_HIAWATHA_WITH_IPV6
	bool "enable ipv6"
	depends on FREETZ_PACKAGE_HIAWATHA
	default n
	help
		This option enable ipv6 for hiawatha

config FREETZ_PACKAGE_HIAWATHA_WITH_TOOLKIT
	bool "enable toolkit"
	depends on FREETZ_PACKAGE_HIAWATHA
	default n
	help
		This option enable toolkit for hiawatha

config FREETZ_PACKAGE_HIAWATHA_WITH_MONITOR
	bool "enable monitor"
	depends on FREETZ_PACKAGE_HIAWATHA
	default n
	help
		This option enable monitor for hiawatha

config FREETZ_PACKAGE_HIAWATHA_WITH_XSLT
	bool "enable xslt"
	depends on FREETZ_PACKAGE_HIAWATHA
	select FREETZ_PACKAGE_XSLTPROC
	select FREETZ_LIB_libxml2
	select FREETZ_LIB_libxml2_WITH_HTML
	select FREETZ_LIB_libxslt
	default n
	help
		This option enable xslt for hiawatha

config FREETZ_PACKAGE_HIAWATHA_WITH_WIGWAM
	bool "wigwam (binary only)"
	depends on FREETZ_PACKAGE_HIAWATHA
	default n
	help
		This option adds wigwam

config FREETZ_PACKAGE_HIAWATHA_WITH_SSI_CGI
	bool "ssi-cgi (binary only)"
	depends on FREETZ_PACKAGE_HIAWATHA
	default n
	help
		This option adds ssi-cgi

config FREETZ_PACKAGE_HIAWATHA_WITH_PHP_FCGI
	bool "php-fcgi (binary only)"
	depends on FREETZ_PACKAGE_HIAWATHA
	default n
	help
		This option adds php-fcgi

config FREETZ_PACKAGE_HIAWATHA_WITH_CGI_WRAPPER
	bool "cgi-wrapper (binary only)"
	depends on FREETZ_PACKAGE_HIAWATHA
	default n
	help
		This option adds cgi-wrapper
```

## branches/private/kriegaex/sf3978_packages/make/hping3/Config.in
```kconfig
config FREETZ_PACKAGE_HPING3
	bool "hping3 20051105 (binary only)"
	select FREETZ_LIB_libpcap
	select FREETZ_LIB_libpthread
	default n
	help
		  hping3 is a command-line oriented TCP/IP packet assembler/analyzer.
		  The interface is inspired to the ping(8) unix command, but hping3
		  isn't only able to send ICMP echo requests. It supports TCP, UDP,
		  ICMP and RAW-IP protocols, has a traceroute mode, the ability to
		  send files between a covered channel, and many other features.
		  WWW: http://www.hping.org/
```

## branches/private/kriegaex/sf3978_packages/make/icbirc/Config.in
```kconfig
config FREETZ_PACKAGE_ICBIRC
	bool "icbirc 1.8 (binary only)"
	default n
	help
		icbirc is a proxy that allows to connect an IRC client to an ICB server.
		The proxy accepts client connections, connects to the server, and for-
		wards data between those two connections.
		Commands from the IRC client are translated to ICB commands and forwarded
		to the ICB server. Messages from the ICB server are translated to IRC
		messages and forwarded to the IRC client.
		ICB (Internet citizen's band) an obscure teleconferencing system used
		primarily by alumni of certain universities (also called Internet CB or
		International CB).
		IRC (Internet Relay Chat) and ICB (Internet Citizen's Band) are two sepa-
		rate chat protocols.  ICB is an older and simpler protocol, basically a
		subset of IRC.  The two most significant differences (from the client's
		perspective) are:
		An ICB client can only join a single channel (called group).  Joining a
		second channel automatically parts the first channel.
		An ICB channel can only have a single operator (called moderator). Giv-
		ing operator status to a second client automatically removes operator
		status from the first client.
		WWW: http://www.benzedrine.cx/icbirc.html
```

## branches/private/kriegaex/sf3978_packages/make/icecast/Config.in
```kconfig
config FREETZ_PACKAGE_ICECAST
	bool "icecast 1.3.12 (binary only)"
	select FREETZ_LIB_libcrypt
	select FREETZ_LIB_libm
	select FREETZ_LIB_libdl
	select FREETZ_LIB_libpthread
	select FREETZ_PACKAGE_TCP_WRAPPERS
	default n
	help
		Icecast is a streaming mp3 audio server.
		Icecast provides nearly all the functionality
		of the Shoutcast server. It will accept
		encoding streams from encoders like winamp, shout
		and ices. It can also add itself to a directory
		server such as our own icecast.linuxpower.org or
		Nullsoft's yp.shoutcast.com.
		WWW: http://www.icecast.org/
```

## branches/private/kriegaex/sf3978_packages/make/icmpinfo/Config.in
```kconfig
config FREETZ_PACKAGE_ICMPINFO
	bool "icmpinfo 1.11 (binary only)"
	default n
	help
		icmpinfo is a tool for looking at the icmp messages received on
		the running host. The source code is written by Laurent Demailly,
		and comes from an heavily modified BSD ping source; it comes AS IS
		- no warranty, etc...
		see LICENSE      <dl@hplyot.obspm.fr>
		need to be chmod 4555 , chown root, or run as root [like ping]
```
