## branches/private/kriegaex/sf3978_packages/make/ipcad/Config.in
```kconfig
config FREETZ_PACKAGE_IPCAD
	bool "ipcad 3.7.3 (binary only)"
	select FREETZ_LIB_libpcap
	select FREETZ_LIB_libpthread
	select FREETZ_LIB_libnsl
	default n
	help
		ipcad listens for traffic on the specified interfaces.
	        It has the built-in RSH and NetFlow engines to allow exporting
	        the accounting data the same way as Cisco routers do.
		WWW: http://lionet.info/ipcad/
		Manpage: http://lionet.info/ipcad/man-ipcad.html
		Manpage for ipcad.conf: http://lionet.info/ipcad/man-ipcad.conf.html
```

## branches/private/kriegaex/sf3978_packages/make/iperf/Config.in
```kconfig
config FREETZ_PACKAGE_IPERF
	bool "iperf 2.0.5 (binary only)"
	select FREETZ_LIB_STDCXXLIB
	default n
	help
		Iperf was developed as a modern alternative for measuring TCP 
		and UDP bandwidth performance. Iperf is a tool to measure
		maximum TCP bandwidth, allowing the tuning of various parameters
		and UDP characteristics. Iperf reports bandwidth, delay jitter, 
		datagram loss.
		WWW: http://iperf.sourceforge.net/
```

## branches/private/kriegaex/sf3978_packages/make/iptotal/Config.in
```kconfig
config FREETZ_PACKAGE_IPTOTAL
	bool "iptotal 0.3.3 (binary only)"
	select FREETZ_LIB_libpcap
	default n
	help
		iptotal is yet another IP traffic monitor. It listens to a network interface in
		non-promiscuous mode, and measures IP bandwidth usage. After the specified
		number of seconds, the average throughput is printed at total, input and output
		usage.
		The utility can be used to measure bandwidth usage without the need for an SNMP
		daemon. Such a daemon is sometimes not wanted for security reasons or simply not
		available for the machine to be measured.
		In combination with a simple script and MRTG or rrdtool it can be used to
		present the measured data in graphical format e.g. through a web interface. 
		WWW: http://dingetje.homeip.net/iptotal/
```

## branches/private/kriegaex/sf3978_packages/make/ircd-hybrid/Config.in
```kconfig
config FREETZ_PACKAGE_IRCD_HYBRID
	bool "ircd-hybird 7.2.3 (binary only)"
	select FREETZ_LIB_libdl if ! FREETZ_PACKAGE_IRCD_HYBRID_STATIC
	select FREETZ_LIB_libresolv if ! FREETZ_PACKAGE_IRCD_HYBRID_STATIC
	default n
	help
		the ircd-hybrid IRC daemon. ircd-hybrid
		includes a number of improvements over a standard
		ircd-2.8 server, including compressed server<->server
		links, chanmode +e, and TS5 support.
		WWW: http://www.ircd-hybrid.org/

config FREETZ_PACKAGE_IRCD_HYBRID_WITH_ZLIB
	bool "With zlib Compression"
	depends on FREETZ_PACKAGE_IRCD_HYBRID
	select FREETZ_LIB_libz if ! FREETZ_PACKAGE_IRCD_HYBRID_STATIC
	default n
	help
		ZLIB Compression for IRC Traffic

config FREETZ_PACKAGE_IRCD_HYBRID_WITH_SSL
	bool "build with SSL support"
	depends on FREETZ_PACKAGE_IRCD_HYBRID
	select FREETZ_LIB_libcrypto if ! FREETZ_PACKAGE_IRCD_HYBRID_STATIC
	select FREETZ_LIB_libssl if ! FREETZ_PACKAGE_IRCD_HYBRID_STATIC
	default n
	help
		This option enables SSL support for ircd-hybird.

config FREETZ_PACKAGE_IRCD_HYBRID_STATIC
	bool "Statically link libraries"
	depends on FREETZ_PACKAGE_IRCD_HYBRID_WITH_SSL
	default n
	help
		ircd-hybrid with SSL support needs the following shared
		libraries which can be linked in statically by activating
		this switch:
		- libcrypto
		- libssl
```

## branches/private/kriegaex/sf3978_packages/make/jftpgw/Config.in
```kconfig
config FREETZ_PACKAGE_JFTPGW
	bool "jftpgw 0.13.5 (binary only)"
	default n
	help
	    jftpgw is an FTP proxy/gateway that uses the FTP protocol (unlike those FTP
	    proxies that fetch an FTP file but work as an http proxy). You can use it to
	    make servers behind a firewall/NAT server (masquerading server) accessible
	    or to allow users behind such solutions to transfer files to and from the
	    outside of the LAN.
	    jftpgw is highly configurable and can be run as a stand-alone daemon or 
	    under control of inetd. A wide range of options can be spedified per client, 
	    server or user. Other features are: support for a transparent proxy mode, 
	    forwarding, file caching, detailed logging, port ranges and session limits.
	    WWW: http://www.mcknight.de/jftpgw/
```

## branches/private/kriegaex/sf3978_packages/make/jtg/Config.in
```kconfig
config FREETZ_PACKAGE_JTG
	bool "jtg v1.95 (binaries only)"
	default n
	help
		The JTG generator is a simple, yet powerful and, if required, accurate
	        traffic generator. jtg differs from other traffic generators in that one
	        instance of a jtg process only sends one stream (e.g. MGEN can send tens
	        of streams) and the characteristics of the stream are given only with
	        command line arguments. On the other hand, a receiving jtg process can
	        be set to loop and receive several streams but, again, only one at a
	        time. The received packets can be logged and the log files can be
	        analyzed with jtg_calc (see later in this file for instructions). jtg6
	        is the binary for IPv6 networks.
		WWW: http://www.netlab.tkk.fi/~jmanner/jtg/Readme.txt
```

## branches/private/kriegaex/sf3978_packages/make/lamahub/Config.in
```kconfig
config FREETZ_PACKAGE_LAMAHUB
	bool "lamahub 0.0.6.3 (binary only)"
	select FREETZ_LIB_libz
	default n
	help
		LamaHub is simple multi-platform NMDC protocol server written in C by ZeXx86.
		Anyway, it is friendly for your cpu, bandwidth and especially with ram.
		WWW: http://lamahub.sourceforge.net/
```

## branches/private/kriegaex/sf3978_packages/make/lft/Config.in
```kconfig
config FREETZ_PACKAGE_LFT
	bool "lft 3.3 (binaries only)"
	select FREETZ_LIB_libpcap
	default n
	help
		  LFT, short for Layer Four Traceroute, is a sort of 'traceroute' that often
		  works much faster (than the commonly-used Van Jacobson method) and goes
		  through many configurations of packet-filters (firewalls). More importantly,
		  LFT implements numerous other features including AS number lookups through
		  several reliable sources, loose source routing, netblock name lookups, et al.
		  What makes LFT unique? LFT is the all-in-one traceroute tool because it can
		  launch a variety of different probes using ICMP, UDP, and TCP protocols, or
		  the RFC1393 trace method. For example, rather than only launching UDP probes
		  in an attempt to elicit ICMP "TTL exceeded" from hosts in the path, LFT can
		  send TCP SYN or FIN probes to target arbitrary services. Then, LFT listens for
		  "TTL exceeded" messages, TCP RST (reset), and various other interesting heuristics
		  from firewalls or other gateways in the path. LFT also distinguishes between
		  TCP-based protocols (source and destination), which make its statistics slightly
		  more realistic, and gives a savvy user the ability to trace protocol routes, not
		  just layer-3 (IP) hops. With LFT's verbose output, much can be discovered about
		  a target network. WhoB is a likable whois client (see whois(1)) designed to provide
		  everything a network engineer needs to know about a routed IP address by typing
		  one line and reading one line.
		  LFT and WhoB are released under the open source license.
		  WWW: http://pwhois.org/lft/
		  Manpage: http://pwhois.org/lft/lft-manpage.html
		  Manpage: http://pwhois.org/lft/whob-manpage.html
```

## branches/private/kriegaex/sf3978_packages/make/libs/libnids/Config.in
```kconfig
config FREETZ_LIB_libnids
	bool "libnids (libnids.so)"
	default n
	help
		An implementation of an E-component of Network Intrusion Detection
		System.
```

## branches/private/kriegaex/sf3978_packages/make/lifstat/Config.in
```kconfig
config FREETZ_PACKAGE_LIFSTAT
	bool "lifstat 20100318 (binary only)"
	default n
	help
		lifstat is a linux utility that reads /proc/net/dev and reports
		input and output statistics for available network interfaces over
		a repeating time inteval similar to the BSD 'netstat -i' command.   
		WWW: http://fejes.net/frank/lifstat/
```

## branches/private/kriegaex/sf3978_packages/make/logrotate/Config.in
```kconfig
config FREETZ_PACKAGE_LOGROTATE
	bool "logrotate 3.7.8 (binary only)"
	select FREETZ_LIB_libpopt
	default n
	help
		logrotate is designed to ease administration of systems
		that generate large numbers of log files. It allows automatic
		rotation, compression, removal, and mailing of log files.
		Each log file may be handled daily, weekly, monthly, or when
		it grows too large.
		http://linux.die.net/man/8/logrotate
		http://schlayer.org/logrotate.html
```

## branches/private/kriegaex/sf3978_packages/make/masqmail/Config.in
```kconfig
config FREETZ_PACKAGE_MASQMAIL
	bool "masqmail 0.3.2 (binaries only)"
	select FREETZ_LIB_libpcre
	select FREETZ_LIB_libglib_2
	select FREETZ_LIB_libintl
#	select FREETZ_LIB_libcrypto
	default n
	help
		  Masqmail is a mail server designed for hosts that are not permanently
		  connected to the internet. It handles outgoing messages, i.e. those
		  that are to be sent over the non-permanent link (usually a ppp or slip
		  connection over a modem or ISDN adapter) specially and delivers them
		  only when explicitely told to do so. There is support for multiple
		  providers, it is possible to write different configurations for each
		  one. The configuration chosen is selected at delivery time, so that if
		  for example a delivery of a message failed while connected with
		  provider 1, it may be delivered when connected to provider 2. For each
		  provider another mail host (or none) can be specified.
		  *** HINT: The use of MasqMail is *strongly* discouraged if you have a
		  permanent connection to the internet without a firewall. First
		  because it does not have the ability to block relaying (it relays
		  every mail) and second because there are no capabilities to
		  protect against SPAM.
		  WWW: http://marmaro.de/prog/masqmail/
```

## branches/private/kriegaex/sf3978_packages/make/miau/Config.in
```kconfig
config FREETZ_PACKAGE_MIAU
	bool "miau 0.6.6 (binary only)"
	default n
	help
		  miau is small but quite featured IRC-bouncer - a service
		  a bit like HTTP-proxy, but for IRC-networks.
		  WWW: http://miau.sourceforge.net/index.html
```

## branches/private/kriegaex/sf3978_packages/make/nfdump/Config.in
```kconfig
config FREETZ_PACKAGE_NFDUMP
	bool "nfdump 1.6.2 (binaries only)"
	default n
	help
		 The nfdump tools collect and process netflow data on the command line:
		    NFDUMP tools overview:
		    All tools support netflow v5, v7 and v9.

		    - nfcapd - netflow capture daemon.
		    Reads the netflow data from the network and stores the data into files.
		    Automatically rotate files every n minutes. ( typically ever 5 min )
		    nfcapd reads netflow v5, v7 and v9 flows transparently. You need one
		    nfcapd process for each netflow stream.

		    - nfdump - netflow dump.
		    Reads the netflow data from the files stored by nfcapd. It's syntax is
		    similar to tcpdump. If you like tcpdump you will like nfdump. Displays
		    netflow data and can create lots of top N statistics of flows IP addresses,
		    ports etc ordered by whatever order you like.

		    - nfreplay - netflow replay
		    Reads the netflow data from the files stored by nfcapd and sends it over
		    the network to another host.

		 WWW: http://nfdump.sourceforge.



    
```

## branches/private/kriegaex/sf3978_packages/make/ngrep/Config.in
```kconfig
config FREETZ_PACKAGE_NGREP
	bool "ngrep 1.45 (binary only)"
	select FREETZ_LIB_libpcap
	select FREETZ_LIB_libpcre
	default n
	help
		ngrep a pcap-aware tool that will allow you to specify extended
	        regular expressions to match against data payloads of packets. It
	        currently recognizes TCP, UDP, and ICMP across Ethernet, PPP, SLIP,
	        FDDI, Token Ring and null interfaces, and understands BPF filter
	        logic in the same fashion as more common packet sniffing tools,
	        like tcpdump and snoop.
		WWW: http://ngrep.sourceforge.net
```

## branches/private/kriegaex/sf3978_packages/make/nload/Config.in
```kconfig
config FREETZ_PACKAGE_NLOAD
	bool "nload 0.6.0 (binary only)"
	select FREETZ_LIB_libncurses
	select FREETZ_LIB_libform
	select FREETZ_LIB_libm
	select FREETZ_LIB_libdl
	select FREETZ_LIB_STDCXXLIB
	default n
	help
		  nload is a console application which monitors network traffic and
		  bandwidth usage in real time. It visualizes the in- and outgoing
		  traffic using two graphs and provides additional info like the
		  total amount of transfered data and min/max network usage.
		  Manpage: http://linux.die.net/man/1/nload
```

## branches/private/kriegaex/sf3978_packages/make/nstx/Config.in
```kconfig
config FREETZ_PACKAGE_NSTX
	bool "nstx 1.1-beta6 (binaries only)"
	default n
	help
		NSTX tunneling network-packets over DNS. NSTX (the Nameserver
		Transfer Protocol) makes it possible to create IP tunnels using DNS
		queries and replies for IP packet encapsulation where IP traffic
		other than DNS isn't possible.  This project is not part of the GNU
		Project.
		Lizenz: http://www.gnu.org/licenses/old-licenses/gpl-2.0.html
		WWW: http://savannah.nongnu.org/projects/nstx/
```

## branches/private/kriegaex/sf3978_packages/make/pktstat/Config.in
```kconfig
config FREETZ_PACKAGE_PKTSTAT
	bool "pktstat 1.8.4 (binary only)"
	select FREETZ_LIB_libncurses
	select FREETZ_LIB_libpcap
	default n
	help
		pktstat listens to the network and shows the bandwidth being consumed
		by packets of various kinds in realtime. It understands some protocols
		(including FTP, HTTP, and X11) and adds a descriptive name next to the
		entry.
		Author: David Leonard <leonard at users.sourceforge.net>
		Manpage: http://linux.die.net/man/1/pktstat
```

## branches/private/kriegaex/sf3978_packages/make/psybnc/Config.in
```kconfig
config FREETZ_PACKAGE_PSYBNC
	bool "psybnc 2.3.2-9 (binary only)"
	select FREETZ_LIB_libssl
	select FREETZ_LIB_libcrypto
	default n
	help
		psyBNC is an easy-to-use, multi-user, permanent IRC-Bouncer
		with many features. Some of its features include symmetric
		ciphering of talk and connections (Blowfish and IDEA), the
		possibility of linking multiple bouncers to an internal network
		including a shared partyline, vhost- and relay support to
		connected bouncers and an extensive online help system. Many
		other helpful functions are included. It compiles on Linux,
		FreeBSD, SunOs and Solaris.
		http://www.psybnc.at/index.html
config FREETZ_PACKAGE_PSYBNC
	bool "psybnc 2.3.2-9 (binary only)"
	select FREETZ_LIB_libssl
	select FREETZ_LIB_libcrypto
	default n
	help
		psyBNC is an easy-to-use, multi-user, permanent IRC-Bouncer
		with many features. Some of its features include symmetric
		ciphering of talk and connections (Blowfish and IDEA), the
		possibility of linking multiple bouncers to an internal network
		including a shared partyline, vhost- and relay support to
		connected bouncers and an extensive online help system. Many
		other helpful functions are included. It compiles on Linux,
		FreeBSD, SunOs and Solaris.
		http://www.psybnc.at/index.html
```
