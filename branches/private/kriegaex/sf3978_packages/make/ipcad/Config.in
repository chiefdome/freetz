## branches/private/kriegaex/sf3978_packages/make/redsocks/Config.in
```kconfig
config FREETZ_PACKAGE_REDSOCKS
	bool "redsocks 0.1 (binary only)"
	select FREETZ_LIB_libevent
	default n
	help
		This tool allows you to redirect any TCP connection to SOCKS
		or HTTPS proxy using your firewall, so redirection is system-wide.
		Why is that useful? I can suggest following reasons:
		    * you use tor and don't want any TCP connection to leak
		    * you use DVB ISP and this ISP provides internet connectivity with
		      some special daemon that may be also called "Internet accelerator"
		      and this accelerator acts as proxy. Globax is example of such an
		      accelerator
		Linux/iptables, OpenBSD/pf and FreeBSD/ipfw are supported. Linux/iptables
		is well-tested, other implementations may have bugs, your bugreports are welcome.
		Features:
		Redirect any TCP connection to SOCKS4, SOCKS5 or HTTPS (HTTP/CONNECT) proxy server.
		Login/password authentication is supported for SOCKS5 connections. SOCKS4 supports
		only username, password is ignored. Redirect any HTTP connection to proxy that does
		not support transparent proxying (e.g. old SQUID had broken `acl myport' for such
		connections).  
		WWW: http://darkk.net.ru/redsocks/
```

## branches/private/kriegaex/sf3978_packages/make/rinetd/Config.in
```kconfig
config FREETZ_PACKAGE_RINETD
	bool "rinetd 0.62 (binary only)"
	default n
	help
		Rinetd redirects TCP connections from one IP address and port to another.
		Rinetd is a single-process server which handles any number of connections
		to the address/port pairs specified in the configuration.
		Since rinetd runs as a single process using nonblocking I/O, it is able to
		redirect a large number of connections without a severe impact on the
		machine.
		WWW: http://www.boutell.com/rinetd/
```

## branches/private/kriegaex/sf3978_packages/make/rtpproxy/Config.in
```kconfig
config FREETZ_PACKAGE_RTPPROXY
	bool "rtpproxy 1.2.1 (binary only)"
	select FREETZ_LIB_libpthread
	default n
	help
		  The Sippy RTPproxy is a high-performance software proxy server for
		  RTP streams that can work together with  SIP Express Router (SER),
		  OpenSIPS,  Kamailio, Sippy B2BUA or  reSIProcate B2BUA.
		  The main purpose of RTPproxy originally had been to make the
		  communication between SIP user agents behind NAT(s) (Network Address
		  Translator) possible. Several cases existed when direct end-to-end
		  communication is not possible and RTP streams have to be relayed
		  through another host. The RTPproxy can be used to setup such a relaying
		  host. 
		  WWW: http://b2bua.org/wiki/RTPproxy
```

## branches/private/kriegaex/sf3978_packages/make/sendip/Config.in
```kconfig
config FREETZ_PACKAGE_SENDIP
	bool "sendip 2.5 (binary and modules only)"
	default n
	help
		SendIP is a commandline tool to allow sending arbitrary IP packets.
		SendIP has a large number of command line options to specify the
		content of every header of a NTP, BGP, RIP, RIPng, TCP, UDP, ICMP or
		raw IPv4 and IPv6 packet. It also allows any data to be added to the
		packet.
		WWW: http://www.earth.li/projectpurple/progs/sendip.html
		Manpage: http://manpages.ubuntu.com/manpages/gutsy/man1/sendip.1.html
```

## branches/private/kriegaex/sf3978_packages/make/shout/Config.in
```kconfig
config FREETZ_PACKAGE_SHOUT
	bool "shout 0.8.0 (binary only)"
	default n
	help
		shout feeds an mp3 stream to your icecast server.
		WWW: http://www.icecast.org/
```

## branches/private/kriegaex/sf3978_packages/make/smap/Config.in
```kconfig
config FREETZ_PACKAGE_SMAP
	bool "smap 0.6.0 (binary only)"
	default n
	help
		smap is a simple scanner for SIP enabled devices. smap sends
		off various SIP requests awaiting responses from SIP enabled
		DSL router, proxies and user agents.
```
