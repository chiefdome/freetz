## branches/private/kriegaex/sf3978_packages/make/sshguard/Config.in
```kconfig
config FREETZ_PACKAGE_SSHGUARD
	bool "sshguard 1.5 (binary only)"
	select FREETZ_PACKAGE_IPTABLES
	default n
	help
		  sshguard monitors servers from their logging activity. When logs convey
		  that someone is doing a Bad Thing, sshguard reacts by blocking he/she/it
		  for a bit. Sshguard has a touchy personality: when a naughty tyke insists
		  disturbing your host, it reacts firmer and firmer. sshguard supports many
		  services out of the box, recognizes several log formats, and can operate
		  many firewall systems. Many users appreciate its ease of use, compatibility
		  and feature richness. 
		  WWW: http://www.sshguard.net/
		  FAQs: http://www.sshguard.net/docs/faqs/
```

## branches/private/kriegaex/sf3978_packages/make/sslcat/Config.in
```kconfig
config FREETZ_PACKAGE_SSLCAT
	bool "sslcat 0.1 (binary only)"
	select FREETZ_LIB_libssl
	select FREETZ_LIB_libcrypto
	default n
	help
		SSLCat is a simple Unix utility that reads and writes data
		across an SSL enable network connection. SSLCat accepts a
		hostname and optional port number (443 is used if none is
		specified) and attempts to form a SSLv2 connection to the
		specified host. If all goes well, data is read from stdin
		and sent across the encrypted connection, while incoming
		data from the encrypted connection is sent stdout.
		WWW: http://www.bindshell.net/tools/sslcat
```

## branches/private/kriegaex/sf3978_packages/make/ssocks/Config.in
```kconfig
config FREETZ_PACKAGE_SSOCKS
	bool "ssocks 0.0.8 (binaries only)"
	select FREETZ_LIB_libssl
	select FREETZ_LIB_libcrypto
	default n
	help
		  sSocks is socks5 server, implements RFC 1928 (SOCKS V5) and RFC 1929
		  (Authentication for SOCKS V5), a netcat like tool, which supports
		  socks5 with authentication and a socks5 relay (run a server and send
		  to a another socks5 server).   
		  WWW: http://sourceforge.net/projects/ssocks/
```

## branches/private/kriegaex/sf3978_packages/make/tcpscript/Config.in
```kconfig
config FREETZ_PACKAGE_TCPSCRIPT
	bool "tcpscript 0.2 (binary only)"
	select FREETZ_LIB_libutil
	default n
	help
		tcpscript is a tool that easily allows other people to see
		your terminal session screen in a way similar to the classic
		Unix command, "script". It opens a TCP port that allows
		anyone to connect to it using telnet and see in real time
		what you see on the terminal. For example, you can use "nano"
		in it as a blackboard or as a chat system.
```

## branches/private/kriegaex/sf3978_packages/make/tdetect/Config.in
```kconfig
config FREETZ_PACKAGE_TDETECT
	bool "tdetect 0.2 (binary only)"
	select FREETZ_LIB_libpcap
	default n
	help
		tdetect detects someone running traceroute against your system.
		It does this by detecting UDP (Unix traceroute) or ICMP ECHO (Windows
		traceroute) packets with TTL fields == 1.  
```

## branches/private/kriegaex/sf3978_packages/make/tftp-hpa/Config.in
```kconfig
config FREETZ_PACKAGE_TFTP_HPA
	bool "tftp-hpa 5.1 (binary only)"
	default n
	help
		  Trivial File Transfer Protocol (TFTP) is a file transfer protocol,
		  mainly to serve boot images over the network to other machines (PXE).
		  tftp-hpa is an enhanced version of the BSD TFTP client and server.
		  tftp-hpa is portable, BSD derived tftp server.  It supports advanced
		  options such as blksize, blksize2, tsize, timeout, and utimeout.
		  It also supported rulebased security options. It possesses a number
		  of bugfixes and enhancements over the original. This package contains
		  the server. 
		  WWW: http://www.in.kernel.org/pub/software/network/tftp/
		  Manpage: http://linux.die.net/man/8/tftpd
```

## branches/private/kriegaex/sf3978_packages/make/uudeview/Config.in
```kconfig
config FREETZ_PACKAGE_UUDEVIEW
	bool "uudeview 0.5.20 (binaries only)"
	default n
	help
		  UUDeview is a program that helps you transmit and receive binary files over
		  the Internet, using electronic mail or newsgroups The UUDeview package includes
		  both an encoder and a decoder. The decoder automatically detects the type of
		  encoding used, offering MIME's Base64 and BinHex as well as the popular uuencoding
		  and the less frequently used xxencoding methods. Recently, support for the popular
		  yEnc encoding was also added. The encoder runs the other way around and encodes a
		  binary file for sending it by mail or news.    
		  WWW: http://www.fpx.de/fp/Software/UUDeview/
```

## branches/private/kriegaex/sf3978_packages/make/xz/Config.in
```kconfig
config FREETZ_PACKAGE_XZ
	bool "xz 5.0.3 (binary only)"
	default n
	help
		XZ Utils is free general-purpose data compression software
		with high compression ratio. XZ Utils were written for
		POSIX-like systems, but also work on some not-so-POSIX
		systems. XZ Utils are the successor to LZMA Utils.
		- liblzma is a compression library with API similar to that of zlib.
		- xz is a command line tool with syntax similar to that of gzip.
		WWW: http://tukaani.org/xz/
```
