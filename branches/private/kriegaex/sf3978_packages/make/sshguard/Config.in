## branches/sf3978_packages/make/bacnet-stack/Config.in
```kconfig
config FREETZ_PACKAGE_BACNET_STACK
	bool "bacnet-stack 0.5.9 (binaries only)"
	default n
	help
		This BACnet protocol stack library provides a BACnet application
		layer, network layer and media access (MAC) layer communications
		services. It is an open source, royalty-free library for an embedded
		system, Windows, Linux, or other operating system. Example BACnet
		client and server applications are included.  
		WWW: http://bacnet.sourceforge.net/
```

## branches/sf3978_packages/make/bing/Config.in
```kconfig
config FREETZ_PACKAGE_BING
	bool "bing 1.1.3 (binary only)"
	default n
	help
		bing determines bandwidth  on  a  point-to-point  link  by
		sending  ICMP  ECHO_REQUEST  packets  and  measuring their
		roundtrip times for different packet sizes on each end  of
		the link.
		WWW: http://fgouget.free.fr/bing/index-en.shtml
		Manpage: http://fgouget.free.fr/bing/bing_src-man.shtml
		Readme: http://fgouget.free.fr/bing/bing_src-readme-1st.shtml
```

## branches/sf3978_packages/make/bld/Config.in
```kconfig
config FREETZ_PACKAGE_BLD
	bool "bld 0.3.4.1 (binary only)"
	select FREETZ_LIB_libnsl
	select FREETZ_LIB_libresolv
	default n
	help
		BLD stands for "blacklist daemon" and is intended to serve a blacklist.
		The blacklist is built by simply inserting IP addresses or by using
		submission rate limits based on a maximum number of submissions of the
		same IP address within a minimum time interval. You can build a BLD cluster
		by configuring the daemon to notify other similar daemon(s) every time an
		IP address is added to the blacklist. BLD was primarily designed to fight
		against dictionary-based spams (by making the MTA report to BLD any host
		that tries to send a mail to an unknown user) but can be used by any program.
		As of now, it is highly recommended to USE IT IN A SAFE ENVIRONMENT: access
		control is based on clients IP addresses. This is why, by default, BLD binds
		to localhost and should not accept requests from a machine where non-trusted
		users can be logged in or establish network connections to via other means (PHP
		for example). 
		http://bld.r14.freenix.org/Home/BSD-license
		WWW: http://bld.r14.freenix.org/
		http://bld.r14.freenix.org/Home/Manual-page
```

## branches/sf3978_packages/make/bmon/Config.in
```kconfig
config FREETZ_PACKAGE_BMON
	bool "bmon 2.1.0 (binary only)"
	select FREETZ_LIB_libncurses
	select FREETZ_LIB_libm
	default n
	help
		bmon is a bandwidth monitor capable of retrieving statistics from various
		input modules. It provides various output methods including a curses based
		interface. bmon is intended for debugging and real-time monitoring purposes. 
		WWW: http://www.infradead.org/~tgr/bmon/
```

## branches/sf3978_packages/make/bnc/Config.in
```kconfig
config FREETZ_PACKAGE_BNC
	bool "bnc 2.9.4 (binary only)"
	select FREETZ_LIB_libnet
	default n
	help
		IRC Proxy Daemon that supports virtual hosting.
		A BNC or IRC Bouncer, acts as a proxy for irc,
		allowing you to hide your real IP address and
		use a vhost.
		Bill Fumerola(billf@chc-chimes.com)
		HOW TO - install and configure a BNC:
		http://www.freebsdshell.com/?page_id=108
```

## branches/sf3978_packages/make/bost/Config.in
```kconfig
config FREETZ_PACKAGE_BOST
	bool "bost 0.0.8 (binary only)"
	select FREETZ_LIB_libm
	default n
	help
		A very simple "host" implementation by Patrik Lembke <blambi@chebab.com>
		It is not meant to be a full host replacement etc just translate hostname
		to a IP.  "This program is free software; you can redistribute it and/or
		modify it under the terms of the GNU General Public License as published by
		the Free Software Foundation; either version 3 of the License, or
		(at your option) any later version."
		Usage:
		  For a single host
		  $ bost host
		  For an IP address:
		  $ bost 10.0.0.1
		  or
		  $ bost 2001:6b0:17:f0a0::b3
		  For N hosts
		  $ bost host1 ... hostN
		  For a subnet/range
		  $ bost 192.168.0.0/24
		  Another range
		  $ bost 192.168.0.0/32
		current options are:
		  -h, --help     Show help
		  -d, --double   enable double check
		for example "bost -d foo" would output both the ip(s) of foo
		and the hostname(s) for the ip(s).
		WWW: http://blambi.chebab.com/software/bost/
```

## branches/sf3978_packages/make/bwping/Config.in
```kconfig
config FREETZ_PACKAGE_BWPING
	bool "bwping 1.4 (binary only)"
	default n
	help
		  BWPing is a bandwidth measurement tool based on ICMP echo
		  request/reply.  It is especially well suited for lossy links.
		  BWPing does not not require any special software on the remote
		  host (only the ability to respond on ICMP echo request messages).
		  WWW: http://bwping.sourceforge.net
```

## branches/sf3978_packages/make/capisnoop/Config.in
```kconfig
config FREETZ_PACKAGE_CAPISNOOP
	bool "capisnoop (binaries only)"
	select FREETZ_LIB_libcapi20
	default n
	help
		capisnoop is an ISDN snooper program to display incoming call
		number over ISDN map and CAPI interface.
		WWW: http://www.akk.org/~enrik/fbox/capistuff/
```

## branches/sf3978_packages/make/ccrypt/Config.in
```kconfig
config FREETZ_PACKAGE_CCRYPT
	bool "ccrypt 1.9 (binary only)"
	default n
	help
		  ccrypt is a utility for encrypting and decrypting files and streams.
		  It was designed as a replacement for the standard unix crypt utility,
		  which is notorious for using a very weak encryption algorithm. ccrypt
		  is based on the Rijndael cipher. This cipher is believed to provide
		  very strong security.
		  WWW: http://ccrypt.sourceforge.net/
```

## branches/sf3978_packages/make/cftp/Config.in
```kconfig
config FREETZ_PACKAGE_CFTP
	bool "cftp 0.12 (binary only)"
	select FREETZ_LIB_libncurses
	default n
	help
		  This is comfortable FTP, a full screen ftp client.
		  Supported are FTP both, with active and passive data
		  connections.
		  WWW: http://nih.at/cftp/index.html
```
