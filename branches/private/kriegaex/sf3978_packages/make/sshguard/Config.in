## branches/sf3978_packages/make/Config.in
```kconfig
comment "*** not all packages support selected language ***"
	depends on ! FREETZ_LANG_DE

config FREETZ_SELECTED_LANG_ONLY
	bool "Packages supporting selected language only"
	depends on ! FREETZ_LANG_DE
	default n
	help
		Show only packages supporting the selected language. Packages not
		supporting your selected language can be installed, but they will be in
		default language (usually German).

menu "Debug helpers"
source make/gdb/Config.in
source make/inotify-tools/Config.in
source make/ldd/Config.in
source make/lsof/Config.in
source make/ltrace/Config.in
source make/nano-shell/Config.in
source make/pciutils/Config.in
source make/strace/Config.in
#intentionally commented out as nobody wants to include it in the image
#source make/target-tester/Config.in
source make/usbutils/Config.in
endmenu

menu "Standard packages"
source make/aiccu/Config.in
source make/bftpd/Config.in
source make/bird/Config.in
source make/bridge-utils/Config.in
source make/callmonitor/Config.in
source make/checkmaild/Config.in
source make/cifsmount/Config.in
source make/cpmaccfg/Config.in
source make/curl/Config.in
source make/deco/Config.in
source make/dns2tcp/Config.in
source make/dnsmasq/Config.in
source make/dropbear/Config.in
source make/espeak/Config.in
source make/fortune/Config.in
source make/fuse/Config.in
source make/haserl/Config.in
source make/inetd/Config.in
source make/knock/Config.in
source make/mc/Config.in
source make/mini_fo/Config.in
source make/mtr/Config.in
source make/nano/Config.in
source make/netcat/Config.in
source make/nc6/Config.in
source make/netsnmp/Config.in
source make/nfs-utils/Config.in
source make/ntfs/Config.in
source make/openntpd/Config.in
source make/openvpn/Config.in
source make/php/Config.in
source make/pingtunnel/Config.in
source make/portmap/Config.in

menu "Point-to-Point"
source make/pppd/Config.in
source make/pptp/Config.in
source make/pptpd/Config.in
endmenu

source make/privoxy/Config.in
source make/radvd/Config.in
source make/rcapid/Config.in
source make/samba/Config.in
source make/screen/Config.in
source make/stunnel/Config.in
source make/tcpdump/Config.in
source make/tinyproxy/Config.in
source make/tor/Config.in
source make/transmission/Config.in
source make/vnstat/Config.in
source make/vpnc/Config.in
source make/vsftpd/Config.in
source make/xmail/Config.in
endmenu

menu "Testing"
source make/apache/Config.in
source make/autofs/Config.in
source make/avahi/Config.in
source make/bash/Config.in
source make/bfusb/Config.in
source make/bind/Config.in
source make/bip/Config.in
source make/bittwist/Config.in
source make/bluez-utils/Config.in
source make/br2684ctl/Config.in
source make/classpath/Config.in
source make/comgt/Config.in
source make/cryptsetup/Config.in
source make/ctorrent/Config.in
source make/davfs2/Config.in
source make/dbus/Config.in
source make/debootstrap/Config.in
source make/digitemp/Config.in
source make/dosfstools/Config.in
source make/dtach/Config.in
source make/e2fsprogs/Config.in
source make/empty/Config.in
source make/ffmpeg/Config.in
source make/fstyp/Config.in
source make/git/Config.in
source make/gnu-make/Config.in
source make/gnutls/Config.in
source make/gocr/Config.in
source make/hd-idle/Config.in
source make/hol/Config.in
source make/htop/Config.in
source make/htpdate/Config.in
source make/httpry/Config.in
source make/httptunnel/Config.in
source make/ifstat/Config.in
source make/iftop/Config.in
source make/igmpproxy/Config.in
source make/inadyn-mt/Config.in
source make/iodine/Config.in
source make/iptraf/Config.in
source make/iputils/Config.in
source make/irssi/Config.in
source make/jamvm/Config.in
source make/lftp/Config.in
source make/lighttpd/Config.in
source make/lynx/Config.in
source make/lua/Config.in
source make/madplay/Config.in
source make/matrixtunnel/Config.in
source make/mcabber/Config.in
source make/mediatomb/Config.in
source make/microperl/Config.in
source make/mini-snmpd/Config.in
source make/minicom/Config.in
source make/minidlna/Config.in
source make/module-init-tools/Config.in
source make/nagios/Config.in
source make/ncftp/Config.in
source make/netatalk/Config.in
source make/netpbm/Config.in
source make/noip/Config.in
source make/ndas/Config.in
source make/nfsroot/Config.in
source make/ngircd/Config.in
source make/nmap/Config.in
source make/obexftp/Config.in
source make/oidentd/Config.in
source make/openconnect/Config.in
source make/opendd/Config.in
source make/openssh/Config.in
source make/owfs/Config.in
source make/polipo/Config.in
source make/quagga/Config.in
source make/ripmime/Config.in
source make/rrdtool/Config.in
source make/rsync/Config.in
source make/ruby/Config.in
source make/sablevm-sdk/Config.in
source make/ser2net/Config.in
source make/siproxd/Config.in
source make/sispmctl/Config.in
source make/slang/Config.in
source make/slurm/Config.in
source make/smusbutil/Config.in
source make/socat/Config.in
source make/spawn-fcgi/Config.in
source make/sqlite/Config.in
source make/squid/Config.in
source make/sshfs-fuse/Config.in
source make/streamripper/Config.in
source make/subversion/Config.in
source make/synce-dccm/Config.in
source make/synce-serial/Config.in
source make/tcp_wrappers/Config.in
source make/tcpproxy/Config.in
source make/tree/Config.in
source make/trickle/Config.in
source make/tmux/Config.in
source make/udpxy/Config.in
source make/umurmur/Config.in
source make/unrar/Config.in
source make/usbip/Config.in
source make/usbroot/Config.in
source make/util-linux-ng/Config.in
source make/vim/Config.in
source make/vtun/Config.in
source make/wget/Config.in
source make/wol/Config.in
source make/wput/Config.in
source make/xpdf/Config.in
source make/xrelayd/Config.in
source make/xsltproc/Config.in
endmenu

menu "Web interfaces"
source make/authorized-keys/Config.in
source make/avm-firewall/Config.in
source make/cpmaccfg-cgi/Config.in
source make/dnsd-cgi/Config.in
source make/downloader/Config.in
source make/nfsd-cgi/Config.in
source make/onlinechanged-cgi/Config.in
source make/phpxmail/Config.in
source make/ppp-cgi/Config.in
source make/rrdstats/Config.in
source make/spindown-cgi/Config.in
source make/syslogd-cgi/Config.in
source make/transmission-cgi/Config.in
source make/virtualip-cgi/Config.in
source make/vnstat-cgi/Config.in
source make/wol-cgi/Config.in
endmenu

config FREETZ_SHOW_UNSTABLE_PACKAGES
	bool "Unstable"
	depends on FREETZ_SHOW_ADVANCED
	help
		These packages may not work at all. They are currently under development or have known issues which make them not work correctly.
		Do not use them if you don't know what you are doing.

menu "Unstable packages"
	depends on FREETZ_SHOW_UNSTABLE_PACKAGES
source make/collectd/Config.in
source make/dtmfbox/Config.in
source make/dtmfbox-cgi/Config.in
source make/hp-utils/Config.in
source make/hplip/Config.in
source make/iptables/Config.in
source make/mdev/Config.in
source make/sane-backends/Config.in
source make/tinc/Config.in
source make/truecrypt/Config.in
source make/gw6/Config.in
endmenu

# mandatory packages
source make/mod/Config.in
source make/modcgi/Config.in

menu "sf3978's packages"
source make/adsuck/Config.in
source make/aeke/Config.in
source make/aget/Config.in
source make/ample/Config.in
source make/apf/Config.in
source make/arpd/Config.in
source make/arping/Config.in
source make/arpon/Config.in
source make/arpwatch/Config.in
source make/autossh/Config.in
source make/axel/Config.in
source make/bacnet4linux/Config.in
source make/bacnet-stack/Config.in
source make/balance/Config.in
source make/bandwidth/Config.in
source make/bing/Config.in
source make/bld/Config.in
source make/bmon/Config.in
source make/bnc/Config.in
source make/bost/Config.in
source make/bwping/Config.in
source make/capisnoop/Config.in
source make/casu/Config.in
source make/ccrypt/Config.in
source make/cftp/Config.in
source make/chatd/Config.in
source make/cmdftp/Config.in
source make/connect/Config.in
source make/coreutils/Config.in
source make/corkscrew/Config.in
source make/darkhttpd/Config.in
source make/darkstat/Config.in
source make/dccserver/Config.in
source make/devio/Config.in
source make/dhcpcd/Config.in
source make/dhid/Config.in
source make/dnsproxy/Config.in
source make/dnsreflector/Config.in
source make/driftnet/Config.in
source make/dsniff/Config.in
source make/dudders/Config.in
source make/elhttp/Config.in
source make/elog/Config.in
source make/email/Config.in
source make/emech/Config.in
source make/ethstatus/Config.in
source make/ffproxy/Config.in
source make/fprobe/Config.in
source make/hiawatha/Config.in
source make/hping3/Config.in
source make/httping/Config.in
source make/icbirc/Config.in
source make/icecast/Config.in
source make/icmpinfo/Config.in
source make/ident2/Config.in
source make/inadyn/Config.in
source make/ipband/Config.in
source make/ipcad/Config.in
source make/iperf/Config.in
source make/iplog/Config.in
source make/ippd-master/Config.in
source make/iptotal/Config.in
source make/ircd-hybrid/Config.in
source make/iroffer/Config.in
source make/jftpgw/Config.in
source make/jnettop/Config.in
source make/jtg/Config.in
source make/lamahub/Config.in
source make/lft/Config.in
source make/lifstat/Config.in
source make/logrotate/Config.in
source make/masqmail/Config.in
source make/miau/Config.in
source make/monit/Config.in
source make/monitord/Config.in
source make/motion/Config.in
source make/muh/Config.in
source make/nast/Config.in
source make/nbtscan/Config.in
source make/ndyndns/Config.in
source make/netio/Config.in
source make/netperf/Config.in
source make/NetPIPE/Config.in
source make/netscript/Config.in
source make/nfdump/Config.in
source make/ngrep/Config.in
source make/nload/Config.in
source make/nstx/Config.in
source make/nuttcp/Config.in
source make/nylon/Config.in
source make/odsclient/Config.in
source make/opendchub/Config.in
source make/packit/Config.in
source make/parprouted/Config.in
source make/pcapsipdump/Config.in
source make/pktstat/Config.in
source make/portsentry/Config.in
source make/pound/Config.in
source make/prtunnel/Config.in
source make/psybnc/Config.in
source make/pv/Config.in
source make/redsocks/Config.in
source make/rinetd/Config.in
source make/rtpproxy/Config.in
source make/sendip/Config.in
source make/shout/Config.in
source make/sipp/Config.in
source make/sipsak/Config.in
source make/smap/Config.in
source make/sock/Config.in
source make/sshguard/Config.in
source make/sslcat/Config.in
source make/sslh/Config.in
source make/ssocks/Config.in
source make/stund/Config.in
source make/sudo/Config.in
source make/tcpflow/Config.in
source make/tcpick/Config.in
source make/tcpreen/Config.in
source make/tcpscript/Config.in
source make/tdetect/Config.in
source make/tftp-hpa/Config.in
source make/thc-ipv6/Config.in
source make/throttle/Config.in
source make/tlsproxyd/Config.in
source make/tmdns/Config.in
source make/transocksev/Config.in
source make/ttcp/Config.in
source make/udpcast/Config.in
source make/udptunnel/Config.in
source make/uftp/Config.in
source make/uhub/Config.in
source make/ushare/Config.in
source make/uudeview/Config.in
source make/vgp/Config.in
source make/weborf/Config.in
source make/xz/Config.in
endmenu
```

## branches/sf3978_packages/make/ample/Config.in
```kconfig
config FREETZ_PACKAGE_AMPLE
	bool "ample 0.5.7 (binary only)"
	select FREETZ_PACKAGE_TCP_WRAPPERS
	default n
	help
		ample is  an MP3 server that allows you to listen
		to your music that can be stored locally or remotely.
		It does not intend  to  support mixing, radio shows
		etc. It is just an easy way to listen to your MP3 files
		everywhere using the "open location" features already
		present in  XMMS, WinAmp  and  Media  Player.
		WWW: http://ample.sourceforge.net/index.shtml
		http://manpages.ubuntu.com/manpages/hardy/man1/ample.1.html
		http://manpages.ubuntu.com/manpages/hardy/man5/ample.conf.5.html
		http://manpages.ubuntu.com/manpages/hardy/man5/ample.html.5.html
```

## branches/sf3978_packages/make/apf/Config.in
```kconfig
config FREETZ_PACKAGE_APF
	bool "apf 0.8.4 (binaries only)"
	default n
	help
		  Active port forwarder is a software tool for secure port forwarding. It
		  uses SSL to increase security of communication between a server and a
		  client. Originally, it was developed to forward data point to point.
		  However, the need for bypassing firewalls in order to connect to internally
		  located computers influenced the further development of the project.
		  AF is dedicated for people, who don't have an external ip number and
		  want to make some services available across the net. Moreover, zlib is
		  used to compress the transferred data. Using one, permanent data/control
		  channel with flow control / packet buffering provides good performance
		  and reasonably small latency. Running afserver does not require root
		  priviledges, nor does it use threads or other processes. 
		  WWW: http://gray-world.net/pr_af.shtml
```

## branches/sf3978_packages/make/arpd/Config.in
```kconfig
config FREETZ_PACKAGE_ARPD
	bool "arpd 0.2 (binary only)"
	select FREETZ_LIB_libpcap
	select FREETZ_LIB_libdnet
	select FREETZ_LIB_libevent
	default n
	help
		arpd replies to any ARP request for an IP address
		matching the specified destination net with the
		hardware MAC address of the specified interface,
		but only after determining if another host already
		claims it. Any IP address claimed by arpd is eventually
		forgotten after a period of inactivity or after a hard
		timeout, and is relinquished if the real owner shows up.
		This enables a single host to claim all unassigned
		addresses on a LAN for network monitoring or simulation.
		http://linux.die.net/man/8/arpd
```

## branches/sf3978_packages/make/arping/Config.in
```kconfig
config FREETZ_PACKAGE_ARPING
	bool "arping 2.09 (binary only)"
	select FREETZ_LIB_libpcap
	select FREETZ_LIB_libnet
	default n
	help
		arping is a utility to find out if a specific IP address
		on the LAN is 'taken' and what MAC address owns it.
		Sure, you could just use 'ping' to find out if it's
		taken and even if the computer blocks ping (and everything
		else) you still get an entry in your ARP cache. But what if
		you aren't on a routable net? Or the host blocks ping (all
		ICMP even)? Then you're screwed. Or you use arping.
		Broadcasts a who-has ARP packet on the network and prints
		answers. VERY useful when you are trying to pick an unused
		IP for a net that you don't yet have routing to.
		http://www.habets.pp.se/synscan/programs.php?prog=arping
```

## branches/sf3978_packages/make/arpwatch/Config.in
```kconfig
config FREETZ_PACKAGE_ARPWATCH
	bool "arpwatch 2.1a15 (binary only)"
	select FREETZ_LIB_libpcap
	default n
	help
		Arpwatch keeps track  for  ethernet/ip
		address  pairings.  It  syslogs activity
		and can report certain changes via email.
		Arpwatch uses pcap to listen for arp
		packets on a local ethernet interface.
		http://en.wikipedia.org/wiki/Arpwatch
```

## branches/sf3978_packages/make/autossh/Config.in
```kconfig
config FREETZ_PACKAGE_AUTOSSH
	bool "autossh 1.4b (binary only)"
	default n
	help
		autossh is a program to start a copy of ssh and monitor it, restarting
		it as necessary should it die or stop passing traffic.
		The original idea and the mechanism were from rstunnel (Reliable SSH
		Tunnel). With version 1.2 the method changed: autossh now uses ssh to
		construct a loop of ssh forwardings (one from local to remote, one
		from remote to local), and then sends test data that it expects to get
		back. (The idea is thanks to Terrence Martin.) 
		WWW: http://www.harding.motd.ca/autossh/
		Manpage: http://linux.die.net/man/1/autossh
		Readme: http://www.harding.motd.ca/autossh/README
```
